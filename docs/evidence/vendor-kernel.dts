/dts-v1/;

/* 由 tools/collect_sc5338.py 从 docs/evidence/vendor-kernel.dtb 反编译。
   phandle 数值保持原样；引用型属性里出现的 phandle 在行尾注释或 &{/path} 中标出。
   这不是 dtc 输出，不能直接编译，仅作 S4602 板级 DTS 的取证/改写参考。 */

/ {
	#address-cells = <0x1>;
	#size-cells = <0x1>;
	compatible = "rockchip,rv1126-38x38-v10-spi-nand", "rockchip,rv1126";
	interrupt-parent = <0x1>;
	model = "Rockchip RV1126 38x38 V10 SPI NAND DDR3 Board";
	ddr_timing {
		compatible = "rockchip,ddr-timing";
		ddr2_speed_bin = "", "", "", "";
		ddr3_speed_bin = <0x15>;
		ddr4_speed_bin = <0xc>;
		pd_idle = <0xd>;
		sr_idle = <0x5d>;
		sr_mc_gate_idle = "", "", "", "";
		srpd_lite_idle = "", "", "", "";
		standby_idle = "", "", "", "";
		auto_pd_dis_freq = <0x42a>;
		auto_sr_dis_freq = <0x320>;
		ddr2_dll_dis_freq = <0x12c>;
		ddr3_dll_dis_freq = <0x12c>;
		ddr4_dll_dis_freq = <0x271>;
		phy_dll_dis_freq = <0x190>;
		ddr2_odt_dis_freq = <0x64>;
		phy_ddr2_odt_dis_freq = <0x64>;
		ddr2_drv = <0x2>;
		ddr2_odt = <0x40>;
		phy_ddr2_ca_drv = <0x15>;
		phy_ddr2_ck_drv = <0x13>;
		phy_ddr2_dq_drv = <0x15>;
		phy_ddr2_odt = <0x2>;
		ddr3_odt_dis_freq = <0x14d>;
		phy_ddr3_odt_dis_freq = <0x14d>;
		ddr3_drv = <0x2>;
		ddr3_odt = <0x40>;
		phy_ddr3_ca_drv = <0x13>;
		phy_ddr3_ck_drv = <0x14>;
		phy_ddr3_dq_drv = <0x17>;
		phy_ddr3_odt = <0x4>;
		phy_lpddr2_odt_dis_freq = <0x14d>;
		lpddr2_drv = <0x2>;
		phy_lpddr2_ca_drv = <0x16>;
		phy_lpddr2_ck_drv = <0x14>;
		phy_lpddr2_dq_drv = <0x16>;
		phy_lpddr2_odt = "", "", "", "";
		lpddr3_odt_dis_freq = <0x14d>;
		phy_lpddr3_odt_dis_freq = <0x14d>;
		lpddr3_drv = <0x1>;
		lpddr3_odt = <0x2>;
		phy_lpddr3_ca_drv = <0x15>;
		phy_lpddr3_ck_drv = <0x16>;
		phy_lpddr3_dq_drv = <0x19>;
		phy_lpddr3_odt = <0x4>;
		lpddr4_odt_dis_freq = <0x14d>;
		phy_lpddr4_odt_dis_freq = <0x14d>;
		lpddr4_drv = <0x30>;
		lpddr4_dq_odt = <0x1>;
		lpddr4_ca_odt = "", "", "", "";
		phy_lpddr4_ca_drv = <0x13>;
		phy_lpddr4_ck_cs_drv = <0x15>;
		phy_lpddr4_dq_drv = <0x15>;
		phy_lpddr4_odt = <0x12>;
		ddr4_odt_dis_freq = <0x271>;
		phy_ddr4_odt_dis_freq = <0x271>;
		ddr4_drv = "", "", "", "";
		ddr4_odt = <0x200>;
		phy_ddr4_ca_drv = <0x13>;
		phy_ddr4_ck_drv = <0x15>;
		phy_ddr4_dq_drv = <0x15>;
		phy_ddr4_odt = <0x4>;
		a0_a3_a3_cke1-a_de-skew = <0x7>;
		a1_ba1_null_cke0-b_de-skew = <0x7>;
		a2_a9_a9_a4-a_de-skew = <0x7>;
		a3_a15_null_a5-b_de-skew = <0x7>;
		a4_a6_a6_ck-a_de-skew = <0x7>;
		a5_a12_null_odt0-b_de-skew = <0x7>;
		a6_ba2_null_a0-a_de-skew = <0x7>;
		a7_a4_a4_odt0-a_de-skew = <0x7>;
		a8_a1_a1_cke0-a_de-skew = <0x7>;
		a9_a5_a5_a5-a_de-skew = <0x7>;
		a10_a8_a8_clkb-a_de-skew = <0x7>;
		a11_a7_a7_ca2-a_de-skew = <0x7>;
		a12_rasn_null_ca1-a_de-skew = <0x7>;
		a13_a13_null_ca3-a_de-skew = <0x7>;
		a14_a14_null_csb1-b_de-skew = <0x7>;
		a15_a10_null_ca0-b_de-skew = <0x7>;
		a16_a11_null_csb0-b_de-skew = <0x7>;
		a17_null_null_null_de-skew = <0x7>;
		ba0_csb1_csb1_csb0-a_de-skew = <0x7>;
		ba1_wen_null_cke1-b_de-skew = <0x7>;
		bg0_odt1_odt1_csb1-a_de-skew = <0x7>;
		bg1_a2_a2_odt1-a_de-skew = <0x7>;
		cke0_casb_null_ca1-b_de-skew = <0x7>;
		ck_ck_ck_ck-b_de-skew = <0x7>;
		ckb_ckb_ckb_ckb-b_de-skew = <0x7>;
		csb0_odt0_odt0_ca2-b_de-skew = <0x7>;
		odt0_csb0_csb0_ca4-b_de-skew = <0x7>;
		resetn_resetn_null-resetn_de-skew = <0x7>;
		actn_cke_cke_ca3-b_de-skew = <0x7>;
		cke1_null_null_null_de-skew = <0x7>;
		csb1_ba0_null_null_de-skew = <0x7>;
		odt1_a0_a0_odt1-b_de-skew = <0x7>;
		cs0_dm0_rx_de-skew = <0x7>;
		cs0_dq0_rx_de-skew = <0x7>;
		cs0_dq1_rx_de-skew = <0x7>;
		cs0_dq2_rx_de-skew = <0x7>;
		cs0_dq3_rx_de-skew = <0x7>;
		cs0_dq4_rx_de-skew = <0x7>;
		cs0_dq5_rx_de-skew = <0x7>;
		cs0_dq6_rx_de-skew = <0x7>;
		cs0_dq7_rx_de-skew = <0x7>;
		cs0_dqs0p_rx_de-skew = <0xe>;
		cs0_dqs0n_rx_de-skew = <0xe>;
		cs0_dm1_rx_de-skew = <0x7>;
		cs0_dq8_rx_de-skew = <0x7>;
		cs0_dq9_rx_de-skew = <0x7>;
		cs0_dq10_rx_de-skew = <0x7>;
		cs0_dq11_rx_de-skew = <0x7>;
		cs0_dq12_rx_de-skew = <0x7>;
		cs0_dq13_rx_de-skew = <0x7>;
		cs0_dq14_rx_de-skew = <0x7>;
		cs0_dq15_rx_de-skew = <0x7>;
		cs0_dqs1p_rx_de-skew = <0xe>;
		cs0_dqs1n_rx_de-skew = <0xe>;
		cs0_dm0_tx_de-skew = <0x7>;
		cs0_dq0_tx_de-skew = <0x7>;
		cs0_dq1_tx_de-skew = <0x7>;
		cs0_dq2_tx_de-skew = <0x7>;
		cs0_dq3_tx_de-skew = <0x7>;
		cs0_dq4_tx_de-skew = <0x7>;
		cs0_dq5_tx_de-skew = <0x7>;
		cs0_dq6_tx_de-skew = <0x7>;
		cs0_dq7_tx_de-skew = <0x7>;
		cs0_dqs0p_tx_de-skew = <0x7>;
		cs0_dqs0n_tx_de-skew = <0x7>;
		cs0_dm1_tx_de-skew = <0x7>;
		cs0_dq8_tx_de-skew = <0x7>;
		cs0_dq9_tx_de-skew = <0x7>;
		cs0_dq10_tx_de-skew = <0x7>;
		cs0_dq11_tx_de-skew = <0x7>;
		cs0_dq12_tx_de-skew = <0x7>;
		cs0_dq13_tx_de-skew = <0x7>;
		cs0_dq14_tx_de-skew = <0x7>;
		cs0_dq15_tx_de-skew = <0x7>;
		cs0_dqs1p_tx_de-skew = <0x7>;
		cs0_dqs1n_tx_de-skew = <0x7>;
		cs0_dm2_rx_de-skew = <0x7>;
		cs0_dq16_rx_de-skew = <0x7>;
		cs0_dq17_rx_de-skew = <0x7>;
		cs0_dq18_rx_de-skew = <0x7>;
		cs0_dq19_rx_de-skew = <0x7>;
		cs0_dq20_rx_de-skew = <0x7>;
		cs0_dq21_rx_de-skew = <0x7>;
		cs0_dq22_rx_de-skew = <0x7>;
		cs0_dq23_rx_de-skew = <0x7>;
		cs0_dqs2p_rx_de-skew = <0xe>;
		cs0_dqs2n_rx_de-skew = <0xe>;
		cs0_dm3_rx_de-skew = <0x7>;
		cs0_dq24_rx_de-skew = <0x7>;
		cs0_dq25_rx_de-skew = <0x7>;
		cs0_dq26_rx_de-skew = <0x7>;
		cs0_dq27_rx_de-skew = <0x7>;
		cs0_dq28_rx_de-skew = <0x7>;
		cs0_dq29_rx_de-skew = <0x7>;
		cs0_dq30_rx_de-skew = <0x7>;
		cs0_dq31_rx_de-skew = <0x7>;
		cs0_dqs3p_rx_de-skew = <0xe>;
		cs0_dqs3n_rx_de-skew = <0xe>;
		cs0_dm2_tx_de-skew = <0x7>;
		cs0_dq16_tx_de-skew = <0x7>;
		cs0_dq17_tx_de-skew = <0x7>;
		cs0_dq18_tx_de-skew = <0x7>;
		cs0_dq19_tx_de-skew = <0x7>;
		cs0_dq20_tx_de-skew = <0x7>;
		cs0_dq21_tx_de-skew = <0x7>;
		cs0_dq22_tx_de-skew = <0x7>;
		cs0_dq23_tx_de-skew = <0x7>;
		cs0_dqs2p_tx_de-skew = <0x7>;
		cs0_dqs2n_tx_de-skew = <0x7>;
		cs0_dm3_tx_de-skew = <0x7>;
		cs0_dq24_tx_de-skew = <0x7>;
		cs0_dq25_tx_de-skew = <0x7>;
		cs0_dq26_tx_de-skew = <0x7>;
		cs0_dq27_tx_de-skew = <0x7>;
		cs0_dq28_tx_de-skew = <0x7>;
		cs0_dq29_tx_de-skew = <0x7>;
		cs0_dq30_tx_de-skew = <0x7>;
		cs0_dq31_tx_de-skew = <0x7>;
		cs0_dqs3p_tx_de-skew = <0x7>;
		cs0_dqs3n_tx_de-skew = <0x7>;
		cs1_dm0_rx_de-skew = <0x7>;
		cs1_dq0_rx_de-skew = <0x7>;
		cs1_dq1_rx_de-skew = <0x7>;
		cs1_dq2_rx_de-skew = <0x7>;
		cs1_dq3_rx_de-skew = <0x7>;
		cs1_dq4_rx_de-skew = <0x7>;
		cs1_dq5_rx_de-skew = <0x7>;
		cs1_dq6_rx_de-skew = <0x7>;
		cs1_dq7_rx_de-skew = <0x7>;
		cs1_dqs0p_rx_de-skew = <0xe>;
		cs1_dqs0n_rx_de-skew = <0xe>;
		cs1_dm1_rx_de-skew = <0x7>;
		cs1_dq8_rx_de-skew = <0x7>;
		cs1_dq9_rx_de-skew = <0x7>;
		cs1_dq10_rx_de-skew = <0x7>;
		cs1_dq11_rx_de-skew = <0x7>;
		cs1_dq12_rx_de-skew = <0x7>;
		cs1_dq13_rx_de-skew = <0x7>;
		cs1_dq14_rx_de-skew = <0x7>;
		cs1_dq15_rx_de-skew = <0x7>;
		cs1_dqs1p_rx_de-skew = <0xe>;
		cs1_dqs1n_rx_de-skew = <0xe>;
		cs1_dm0_tx_de-skew = <0x7>;
		cs1_dq0_tx_de-skew = <0x7>;
		cs1_dq1_tx_de-skew = <0x7>;
		cs1_dq2_tx_de-skew = <0x7>;
		cs1_dq3_tx_de-skew = <0x7>;
		cs1_dq4_tx_de-skew = <0x7>;
		cs1_dq5_tx_de-skew = <0x7>;
		cs1_dq6_tx_de-skew = <0x7>;
		cs1_dq7_tx_de-skew = <0x7>;
		cs1_dqs0p_tx_de-skew = <0x7>;
		cs1_dqs0n_tx_de-skew = <0x7>;
		cs1_dm1_tx_de-skew = <0x7>;
		cs1_dq8_tx_de-skew = <0x7>;
		cs1_dq9_tx_de-skew = <0x7>;
		cs1_dq10_tx_de-skew = <0x7>;
		cs1_dq11_tx_de-skew = <0x7>;
		cs1_dq12_tx_de-skew = <0x7>;
		cs1_dq13_tx_de-skew = <0x7>;
		cs1_dq14_tx_de-skew = <0x7>;
		cs1_dq15_tx_de-skew = <0x7>;
		cs1_dqs1p_tx_de-skew = <0x7>;
		cs1_dqs1n_tx_de-skew = <0x7>;
		cs1_dm2_rx_de-skew = <0x7>;
		cs1_dq16_rx_de-skew = <0x7>;
		cs1_dq17_rx_de-skew = <0x7>;
		cs1_dq18_rx_de-skew = <0x7>;
		cs1_dq19_rx_de-skew = <0x7>;
		cs1_dq20_rx_de-skew = <0x7>;
		cs1_dq21_rx_de-skew = <0x7>;
		cs1_dq22_rx_de-skew = <0x7>;
		cs1_dq23_rx_de-skew = <0x7>;
		cs1_dqs2p_rx_de-skew = <0xe>;
		cs1_dqs2n_rx_de-skew = <0xe>;
		cs1_dm3_rx_de-skew = <0x7>;
		cs1_dq24_rx_de-skew = <0x7>;
		cs1_dq25_rx_de-skew = <0x7>;
		cs1_dq26_rx_de-skew = <0x7>;
		cs1_dq27_rx_de-skew = <0x7>;
		cs1_dq28_rx_de-skew = <0x7>;
		cs1_dq29_rx_de-skew = <0x7>;
		cs1_dq30_rx_de-skew = <0x7>;
		cs1_dq31_rx_de-skew = <0x7>;
		cs1_dqs3p_rx_de-skew = <0xe>;
		cs1_dqs3n_rx_de-skew = <0xe>;
		cs1_dm2_tx_de-skew = <0x7>;
		cs1_dq16_tx_de-skew = <0x7>;
		cs1_dq17_tx_de-skew = <0x7>;
		cs1_dq18_tx_de-skew = <0x7>;
		cs1_dq19_tx_de-skew = <0x7>;
		cs1_dq20_tx_de-skew = <0x7>;
		cs1_dq21_tx_de-skew = <0x7>;
		cs1_dq22_tx_de-skew = <0x7>;
		cs1_dq23_tx_de-skew = <0x7>;
		cs1_dqs2p_tx_de-skew = <0x7>;
		cs1_dqs2n_tx_de-skew = <0x7>;
		cs1_dm3_tx_de-skew = <0x7>;
		cs1_dq24_tx_de-skew = <0x7>;
		cs1_dq25_tx_de-skew = <0x7>;
		cs1_dq26_tx_de-skew = <0x7>;
		cs1_dq27_tx_de-skew = <0x7>;
		cs1_dq28_tx_de-skew = <0x7>;
		cs1_dq29_tx_de-skew = <0x7>;
		cs1_dq30_tx_de-skew = <0x7>;
		cs1_dq31_tx_de-skew = <0x7>;
		cs1_dqs3p_tx_de-skew = <0x7>;
		cs1_dqs3n_tx_de-skew = <0x7>;
		phandle = <0x7f>;
	};
	aliases {
		ethernet0 = "/ethernet@ffc40000";
		i2c0 = "/i2c@ff3f0000";
		i2c1 = "/i2c@ff510000";
		i2c2 = "/i2c@ff400000";
		i2c3 = "/i2c@ff520000";
		i2c4 = "/i2c@ff530000";
		i2c5 = "/i2c@ff540000";
		mmc0 = "/dwmmc@ffc50000";
		mmc1 = "/dwmmc@ffc70000";
		mmc2 = "/dwmmc@ffc60000";
		serial0 = "/serial@ff560000";
		serial1 = "/serial@ff410000";
		serial2 = "/serial@ff570000";
		serial3 = "/serial@ff580000";
		serial4 = "/serial@ff590000";
		serial5 = "/serial@ff5a0000";
		spi0 = "/spi@ff450000";
		spi1 = "/spi@ff5b0000";
		dphy0 = "/csi-dphy@ff4b0000";
		dphy1 = "/csi-dphy@ff4b8000";
	};
	cpus {
		#address-cells = <0x1>;
		#size-cells = "", "", "", "";
		cpu@f00 {
			device_type = "cpu";
			compatible = "arm,cortex-a7";
			reg = <0xf00>;
			enable-method = "psci";
			clocks = <0x2 0x5>;  /* 0x2->&{/clock-controller@ff490000}, 0x5->&{/vdd-arm-logic-npu-vepu-fixed} */
			operating-points-v2 = <0x3>;
			dynamic-power-coefficient = <0x3c>;
			#cooling-cells = <0x2>;
			cpu-idle-states = <0x4>;
			cpu-supply = <&{/vdd-arm-logic-npu-vepu-fixed}>;
			phandle = <0xa>;
		};
		cpu@f01 {
			device_type = "cpu";
			compatible = "arm,cortex-a7";
			reg = <0xf01>;
			enable-method = "psci";
			clocks = <0x2 0x5>;  /* 0x2->&{/clock-controller@ff490000}, 0x5->&{/vdd-arm-logic-npu-vepu-fixed} */
			operating-points-v2 = <0x3>;
			dynamic-power-coefficient = <0x3c>;
			cpu-idle-states = <0x4>;
			phandle = <0xb>;
		};
		cpu@f02 {
			device_type = "cpu";
			compatible = "arm,cortex-a7";
			reg = <0xf02>;
			enable-method = "psci";
			clocks = <0x2 0x5>;  /* 0x2->&{/clock-controller@ff490000}, 0x5->&{/vdd-arm-logic-npu-vepu-fixed} */
			operating-points-v2 = <0x3>;
			dynamic-power-coefficient = <0x3c>;
			cpu-idle-states = <0x4>;
			phandle = <0xc>;
		};
		cpu@f03 {
			device_type = "cpu";
			compatible = "arm,cortex-a7";
			reg = <0xf03>;
			enable-method = "psci";
			clocks = <0x2 0x5>;  /* 0x2->&{/clock-controller@ff490000}, 0x5->&{/vdd-arm-logic-npu-vepu-fixed} */
			operating-points-v2 = <0x3>;
			dynamic-power-coefficient = <0x3c>;
			cpu-idle-states = <0x4>;
			phandle = <0xd>;
		};
		idle-states {
			entry-method = "psci";
			cpu-sleep {
				compatible = "arm,idle-state";
				local-timer-stop;
				arm,psci-suspend-param = <0x10000>;
				entry-latency-us = <0x78>;
				exit-latency-us = <0xfa>;
				min-residency-us = <0x384>;
				phandle = <0x4>;
			};
		};
	};
	cpu0-opp-table {
		compatible = "operating-points-v2";
		opp-shared;
		nvmem-cells = <0x6 0x7>;
		nvmem-cell-names = "leakage", "performance";
		rockchip,reboot-freq = <0xc7380>;
		rockchip,temp-freq-table = <0x186a0 0x13c680>;
		clocks = <0x2 0x1>;  /* 0x2->&{/clock-controller@ff490000}, 0x1->&{/interrupt-controller@feff0000} */
		rockchip,bin-scaling-sel = <0x0 0x5 0x1 0x12>;
		rockchip,bin-voltage-sel = <0x1 0x0>;
		rockchip,pvtm-voltage-sel = <0x0 0x19e10 0x1 0x19e11 0x1b580 0x2 0x1b581 0xf423f 0x3>;
		rockchip,pvtm-freq = <0x639c0>;
		rockchip,pvtm-volt = <0xc3500>;
		rockchip,pvtm-ch = "", "", "", "", "", "", "", "";
		rockchip,pvtm-sample-time = <0x3e8>;
		rockchip,pvtm-number = <0xa>;
		rockchip,pvtm-error = <0x3e8>;
		rockchip,pvtm-ref-temp = <0x25>;
		rockchip,pvtm-temp-prop = <0xffffffd8 0xd>;
		rockchip,pvtm-thermal-zone = "cpu-thermal";
		phandle = <0x3>;
		opp-408000000 {
			opp-hz = <0x0 0x18519600>;
			opp-microvolt = <0xb1008 0xb1008 0xf4240>;
			opp-microvolt-L0 = <0xb1008 0xb1008 0xf4240>;
			clock-latency-ns = <0x9c40>;
		};
		opp-600000000 {
			opp-hz = <0x0 0x23c34600>;
			opp-microvolt = <0xb1008 0xb1008 0xf4240>;
			opp-microvolt-L0 = <0xb1008 0xb1008 0xf4240>;
			clock-latency-ns = <0x9c40>;
		};
		opp-816000000 {
			opp-hz = <0x0 0x30a32c00>;
			opp-microvolt = <0xb1008 0xb1008 0xf4240>;
			opp-microvolt-L0 = <0xb71b0 0xb71b0 0xf4240>;
			clock-latency-ns = <0x9c40>;
			opp-suspend;
		};
		opp-1008000000 {
			opp-hz = <0x0 0x3c14dc00>;
			opp-microvolt = <0xbd358 0xbd358 0xf4240>;
			opp-microvolt-L0 = <0xc3500 0xc3500 0xf4240>;
			opp-microvolt-L1 = <0xbd358 0xbd358 0xf4240>;
			opp-microvolt-L2 = <0xbd358 0xbd358 0xf4240>;
			opp-microvolt-L3 = <0xb71b0 0xb71b0 0xf4240>;
			clock-latency-ns = <0x9c40>;
		};
		opp-1200000000 {
			opp-hz = <0x0 0x47868c00>;
			opp-microvolt = <0xcf850 0xcf850 0xf4240>;
			opp-microvolt-L0 = <0xd59f8 0xd59f8 0xf4240>;
			opp-microvolt-L1 = <0xcf850 0xcf850 0xf4240>;
			opp-microvolt-L2 = <0xcf850 0xcf850 0xf4240>;
			opp-microvolt-L3 = <0xc96a8 0xc96a8 0xf4240>;
			clock-latency-ns = <0x9c40>;
		};
	};
	cpuinfo {
		compatible = "rockchip,cpuinfo";
		nvmem-cells = <0x8 0x9>;
		nvmem-cell-names = "id", "cpu-code";
	};
	arm-pmu {
		compatible = "arm,cortex-a7-pmu";
		interrupts = <0x0 0x7b 0x4 0x0 0x7c 0x4 0x0 0x7d 0x4 0x0 0x7e 0x4>;
		interrupt-affinity = <0xa 0xb 0xc 0xd>;
	};
	bus-soc {
		compatible = "rockchip,rv1126-bus";
		rockchip,busfreq-policy = "smc";
		phandle = <0xc6>;
		soc-bus0 {
			bus-id = "", "", "", "";
			cfg-val = <0x300020>;
			enable-msk = <0x7144>;
			status = "okay";
		};
		soc-bus1 {
			bus-id = <0x1>;
			cfg-val = <0x300020>;
			enable-msk = <0x70ff>;
			status = "disabled";
		};
		soc-bus2 {
			bus-id = <0x2>;
			cfg-val = <0x300020>;
			enable-msk = <0x70ff>;
			status = "disabled";
		};
		soc-bus3 {
			bus-id = <0x3>;
			cfg-val = <0x300020>;
			enable-msk = <0x70ff>;
			status = "disabled";
		};
		soc-bus4 {
			bus-id = <0x4>;
			cfg-val = <0x300020>;
			enable-msk = <0x7011>;
			status = "disabled";
		};
		soc-bus5 {
			bus-id = <0x5>;
			cfg-val = <0x300020>;
			enable-msk = <0x7011>;
			status = "disabled";
		};
		soc-bus6 {
			bus-id = <0x6>;
			cfg-val = <0x300020>;
			enable-msk = <0x7011>;
			status = "disabled";
		};
		soc-bus7 {
			bus-id = <0x7>;
			cfg-val = <0x300020>;
			enable-msk = "", "", "", "";
			status = "disabled";
		};
		soc-bus8 {
			bus-id = <0x8>;
			cfg-val = <0x300020>;
			enable-msk = "", "", "", "";
			status = "disabled";
		};
		soc-bus9 {
			bus-id = <0x9>;
			cfg-val = <0x300020>;
			enable-msk = "", "", "", "";
			status = "disabled";
		};
		soc-bus10 {
			bus-id = <0xa>;
			cfg-val = <0x300020>;
			enable-msk = "", "", "", "";
			status = "disabled";
		};
		soc-bus11 {
			bus-id = <0xb>;
			cfg-val = <0x300020>;
			enable-msk = "", "", "p";
			status = "disabled";
		};
	};
	display-subsystem {
		compatible = "rockchip,display-subsystem";
		ports = <0xe>;
		status = "okay";
		logo-memory-region = <0xf>;
		phandle = <0xc7>;
		route {
			route-dsi {
				status = "disabled";
				logo,uboot = "logo.bmp";
				logo,kernel = "logo_kernel.bmp";
				logo,mode = "center";
				charge_logo,mode = "center";
				connect = <0x10>;
				phandle = <0xc8>;
			};
			route-rgb {
				status = "disabled";
				logo,uboot = "logo.bmp";
				logo,kernel = "logo_kernel.bmp";
				logo,mode = "center";
				charge_logo,mode = "center";
				connect = <0x11>;
				phandle = <0xc9>;
			};
		};
	};
	fiq-debugger {
		compatible = "rockchip,fiq-debugger";
		rockchip,serial-id = <0x2>;
		rockchip,wake-irq = "", "", "", "";
		rockchip,irq-mode-enable = "", "", "", "";
		rockchip,baudrate = <0x16e360>;
		interrupts = <0x0 0x7f 0x4>;
		status = "okay";
		phandle = <0xca>;
	};
	firmware {
		optee {
			compatible = "linaro,optee-tz";
			method = "smc";
			status = "disabled";
			phandle = <0xcb>;
		};
	};
	mpp-srv {
		compatible = "rockchip,mpp-service";
		rockchip,taskqueue-count = <0x4>;
		rockchip,resetgroup-count = <0x4>;
		status = "okay";
		phandle = <0x86>;
	};
	psci {
		compatible = "arm,psci-1.0";
		method = "smc";
	};
	reserved-memory {
		#address-cells = <0x1>;
		#size-cells = <0x1>;
		ranges;
		linux,cma {
			compatible = "shared-dma-pool";
			inactive;
			reusable;
			size = "", "", "", "";
			linux,cma-default;
		};
		drm-logo@00000000 {
			compatible = "rockchip,drm-logo";
			reg = "", "", "", "", "", "", "", "";
			phandle = <0xf>;
		};
		isp {
			compatible = "shared-dma-pool";
			inactive;
			reusable;
			size = "", "", "", "";
			phandle = <0x13>;
		};
		ramoops@8000000 {
			compatible = "ramoops";
			reg = <0x8000000 0x100000>;
			record-size = <0x20000>;
			console-size = <0x40000>;
			ftrace-size = "", "", "", "";
			pmsg-size = <0x40000>;
			status = "disabled";
			phandle = <0xcc>;
		};
		nouse@0 {
			reg = "", "", "", "", "", "", "@";
			no-map;
		};
	};
	rkcif_dvp {
		compatible = "rockchip,rkcif-dvp";
		rockchip,hw = <0x12>;
		memory-region = <0x13>;
		status = "disabled";
		phandle = <0x14>;
	};
	rkcif_dvp_sditf {
		compatible = "rockchip,rkcif-sditf";
		rockchip,cif = <0x14>;
		status = "disabled";
		phandle = <0xcd>;
	};
	rkcif_lite_mipi_lvds {
		compatible = "rockchip,rkcif-mipi-lvds";
		rockchip,hw = <0x15>;
		iommus = <&{/iommu@ffae8800}>;
		status = "disabled";
		phandle = <0x17>;
	};
	rkcif_lite_sditf {
		compatible = "rockchip,rkcif-sditf";
		rockchip,cif = <0x17>;
		status = "disabled";
		phandle = <0xce>;
	};
	rkcif_mipi_lvds {
		compatible = "rockchip,rkcif-mipi-lvds";
		rockchip,hw = <0x12>;
		memory-region = <0x13>;
		status = "okay";
		phandle = <0x19>;
		port {
			endpoint {
				remote-endpoint = <&{/mipi-csi2@ffb10000/ports/port@1/endpoint@0}>;
				data-lanes = <0x1 0x2>;
				phandle = <0x85>;
			};
		};
	};
	rkcif_mipi_lvds_sditf {
		compatible = "rockchip,rkcif-sditf";
		rockchip,cif = <0x19>;
		status = "okay";
		phandle = <0xcf>;
		port {
			endpoint {
				remote-endpoint = <&{/rkisp-vir0/ports/port@0/endpoint@0}>;
				data-lanes = <0x1 0x2>;
				phandle = <0x8c>;
			};
		};
	};
	rockchip-suspend {
		compatible = "rockchip,pm-rv1126";
		status = "disabled";
		rockchip,sleep-debug-en = "", "", "", "";
		rockchip,sleep-mode-config = <0x20602>;
		rockchip,wakeup-config = <0x10>;
		phandle = <0xd0>;
	};
	rockchip-system-monitor {
		compatible = "rockchip,system-monitor";
		phandle = <0xd1>;
	};
	thermal-zones {
		phandle = <0xd2>;
		cpu-thermal {
			polling-delay-passive = <0x14>;
			polling-delay = <0x3e8>;
			sustainable-power = <0x36b>;
			k_pu = <0x4b>;
			k_po = <0xaf>;
			k_i = "", "", "", "";
			thermal-sensors = <0x1b 0x0>;
			phandle = <0xd3>;
			trips {
				trip-point-0 {
					temperature = <0x124f8>;
					hysteresis = <0x7d0>;
					type = "passive";
					phandle = <0xd4>;
				};
				trip-point-1 {
					temperature = <0x14c08>;
					hysteresis = <0x7d0>;
					type = "passive";
					phandle = <0x1c>;
				};
				soc-crit {
					temperature = <0x1e848>;
					hysteresis = <0x7d0>;
					type = "critical";
					phandle = <0xd5>;
				};
			};
			cooling-maps {
				map0 {
					trip = <0x1c>;
					cooling-device = <0xa 0xffffffff 0xffffffff>;
					contribution = <0x400>;
				};
				map1 {
					trip = <0x1c>;
					cooling-device = <0x1d 0xffffffff 0xffffffff>;
					contribution = <0x400>;
				};
				map2 {
					trip = <0x1c>;
					cooling-device = <0x1e 0xffffffff 0xffffffff>;
					contribution = <0x424>;
				};
			};
		};
		npu-thermal {
			polling-delay-passive = <0x14>;
			polling-delay = <0x3e8>;
			sustainable-power = <0x3d1>;
			thermal-sensors = <0x1f 0x0>;
			phandle = <0xd6>;
		};
	};
	timer {
		compatible = "arm,armv7-timer";
		interrupts = <0x1 0xd 0xf04 0x1 0xe 0xf04 0x1 0xb 0xf04 0x1 0xa 0xf04>;
		clock-frequency = <0x16e3600>;
	};
	oscillator {
		compatible = "fixed-clock";
		clock-frequency = <0x16e3600>;
		clock-output-names = "xin24m";
		#clock-cells = "", "", "", "";
		phandle = <0xd7>;
	};
	dummy_cpll {
		compatible = "fixed-clock";
		clock-frequency = "", "", "", "";
		clock-output-names = "dummy_cpll";
		#clock-cells = "", "", "", "";
		phandle = <0xd8>;
	};
	external-gmac-clockm0 {
		compatible = "fixed-clock";
		clock-frequency = <0x7735940>;
		clock-output-names = "clk_gmac_rgmii_clkin_m0";
		#clock-cells = "", "", "", "";
		phandle = <0xd9>;
	};
	external-gmac-clockm1 {
		compatible = "fixed-clock";
		clock-frequency = <0x7735940>;
		clock-output-names = "clk_gmac_rgmii_clkin_m1";
		#clock-cells = "", "", "", "";
		phandle = <0xda>;
	};
	syscon@fe000000 {
		compatible = "rockchip,rv1126-grf", "syscon", "simple-mfd";
		reg = <0xfe000000 0x20000>;
		phandle = <0x48>;
		rgb {
			compatible = "rockchip,rv1126-rgb";
			status = "disabled";
			phandle = <0xdb>;
			ports {
				#address-cells = <0x1>;
				#size-cells = "", "", "", "";
				port@0 {
					reg = "", "", "", "";
					#address-cells = <0x1>;
					#size-cells = "", "", "", "";
					endpoint@0 {
						reg = "", "", "", "";
						remote-endpoint = <&{/vop@ffb00000/port/endpoint@0}>;
						phandle = <0x82>;
					};
				};
			};
		};
	};
	syscon@fe020000 {
		compatible = "rockchip,rv1126-pmugrf", "syscon", "simple-mfd";
		reg = <0xfe020000 0x1000>;
		phandle = <0x3a>;
		io-domains {
			compatible = "rockchip,rv1126-pmu-io-voltage-domain";
			status = "okay";
			pmuio0-supply = <&{/vcc33sys}>;
			pmuio1-supply = <&{/vcc33sys}>;
			vccio3-supply = <&{/vcc33sys}>;
			vccio4-supply = <&{/vcc-1v8}>;
			vccio5-supply = <&{/vcc33sys}>;
			vccio6-supply = <&{/vcc33sys}>;
			vccio7-supply = <&{/vcc33sys}>;
			phandle = <0xdc>;
		};
		reboot-mode {
			compatible = "syscon-reboot-mode";
			offset = <0x200>;
			mode-bootloader = <0x5242c301>;
			mode-charge = <0x5242c30b>;
			mode-fastboot = <0x5242c309>;
			mode-loader = <0x5242c301>;
			mode-normal = <0x5242c300>;
			mode-recovery = <0x5242c303>;
			mode-ums = <0x5242c30c>;
			mode-panic = <0x5242c307>;
			mode-watchdog = <0x5242c308>;
			mode-dfu = <0x5242c30d>;
		};
	};
	qos@fe810000 {
		compatible = "syscon";
		reg = <0xfe810000 0x20>;
		phandle = <0x36>;
	};
	qos@fe810080 {
		compatible = "syscon";
		reg = <0xfe810080 0x20>;
		phandle = <0x37>;
	};
	qos@fe850000 {
		compatible = "syscon";
		reg = <0xfe850000 0x20>;
		phandle = <0x22>;
	};
	qos@fe860000 {
		compatible = "syscon";
		reg = <0xfe860000 0x20>;
		phandle = <0x32>;
	};
	qos@fe860080 {
		compatible = "syscon";
		reg = <0xfe860080 0x20>;
		phandle = <0x33>;
	};
	qos@fe860200 {
		compatible = "syscon";
		reg = <0xfe860200 0x20>;
		phandle = <0x34>;
	};
	qos@fe86c000 {
		compatible = "syscon";
		reg = <0xfe86c000 0x20>;
		phandle = <0x35>;
	};
	qos@fe870000 {
		compatible = "syscon";
		reg = <0xfe870000 0x20>;
		phandle = <0x23>;
	};
	qos@fe870080 {
		compatible = "syscon";
		reg = <0xfe870080 0x20>;
		phandle = <0x24>;
	};
	qos@fe870100 {
		compatible = "syscon";
		reg = <0xfe870100 0x20>;
		phandle = <0x25>;
	};
	qos@fe880000 {
		compatible = "syscon";
		reg = <0xfe880000 0x20>;
		phandle = <0x2e>;
	};
	qos@fe880080 {
		compatible = "syscon";
		reg = <0xfe880080 0x20>;
		phandle = <0x2f>;
	};
	qos@fe890000 {
		compatible = "syscon";
		reg = <0xfe890000 0x20>;
		priority-init = <0x202>;
		extcontrol-init = "", "", "", "";
		phandle = <0x27>;
	};
	qos@fe890080 {
		compatible = "syscon";
		reg = <0xfe890080 0x20>;
		phandle = <0x28>;
	};
	qos@fe890100 {
		compatible = "syscon";
		reg = <0xfe890100 0x20>;
		phandle = <0x29>;
	};
	qos@fe8a0000 {
		compatible = "syscon";
		reg = <0xfe8a0000 0x20>;
		phandle = <0x2d>;
	};
	qos@fe8a0080 {
		compatible = "syscon";
		reg = <0xfe8a0080 0x20>;
		phandle = <0x2a>;
	};
	qos@fe8a0100 {
		compatible = "syscon";
		reg = <0xfe8a0100 0x20>;
		phandle = <0x2b>;
	};
	qos@fe8a0180 {
		compatible = "syscon";
		reg = <0xfe8a0180 0x20>;
		phandle = <0x2c>;
	};
	qos@fe8b0000 {
		compatible = "syscon";
		reg = <0xfe8b0000 0x20>;
		phandle = <0x30>;
	};
	qos@fe8c0000 {
		compatible = "syscon";
		reg = <0xfe8c0000 0x20>;
		phandle = <0x31>;
	};
	qos@fe8d0000 {
		compatible = "syscon";
		reg = <0xfe8d0000 0x20>;
		phandle = <0x26>;
	};
	interrupt-controller@feff0000 {
		compatible = "arm,gic-400";
		interrupt-controller;
		#interrupt-cells = <0x3>;
		#address-cells = "", "", "", "";
		reg = <0xfeff1000 0x1000 0xfeff2000 0x2000 0xfeff4000 0x2000 0xfeff6000 0x2000>;
		interrupts = <0x1 0x9 0xf04>;
		phandle = <0x1>;
	};
	arm-debug@ff010000 {
		compatible = "rockchip,debug";
		reg = <0xff010000 0x1000 0xff012000 0x1000 0xff014000 0x1000 0xff016000 0x1000>;
	};
	pvtm@ff040000 {
		compatible = "rockchip,rv1126-cpu-pvtm";
		reg = <0xff040000 0x100>;
		#address-cells = <0x1>;
		#size-cells = "", "", "", "";
		pvtm@0 {
			reg = "", "", "", "";
			clocks = <0x2 0x8 0x2 0xf5>;  /* 0x2->&{/clock-controller@ff490000}, 0x8->&{/otp@ff5c0000/id@7}, 0x2->&{/clock-controller@ff490000}, 0xf5->&{/i2c@ff540000} */
			clock-names = "clk", "pclk";
			resets = <0x2 0xec 0x2 0xeb>;  /* 0x2->&{/clock-controller@ff490000}, 0xec->&{/rng@ff500400}, 0x2->&{/clock-controller@ff490000}, 0xeb->&{/csi-dphy@ff4b8000} */
			reset-names = "rst", "rst-p";
		};
	};
	power-management@ff3e0000 {
		compatible = "rockchip,rv1126-pmu", "syscon", "simple-mfd";
		reg = <0xff3e0000 0x1000>;
		phandle = <0xdd>;
		power-controller {
			compatible = "rockchip,rv1126-power-controller";
			#power-domain-cells = <0x1>;
			#address-cells = <0x1>;
			#size-cells = "", "", "", "";
			status = "okay";
			phandle = <0x4d>;
			pd_npu@7 {
				reg = <0x7>;
				clocks = <0x2 0xc3 0x2 0xf0 0x2 0x119 0x2 0x90>;  /* 0x2->&{/clock-controller@ff490000}, 0xc3->&{/codec-digital@ff850000}, 0x2->&{/clock-controller@ff490000}, 0xf0->&{/i2c@ff510000/sc530ai@30}, 0x2->&{/clock-controller@ff490000}, 0x119->&{/vdpu@ffb90400}, 0x2->&{/clock-controller@ff490000}, 0x90->&{/rkispp@ffb60000} */
				pm_qos = <0x22>;
			};
			pd_vepu@8 {
				reg = <0x8>;
				clocks = <0x2 0xa8 0x2 0xd3 0x2 0x56>;  /* 0x2->&{/clock-controller@ff490000}, 0xa8->&{/pinctrl/sdmmc0/sdmmc0-bus4}, 0x2->&{/clock-controller@ff490000}, 0xd3->&{/thermal-zones/cpu-thermal}, 0x2->&{/clock-controller@ff490000}, 0x56->&{/pinctrl/pwm8/pwm8m1-pins} */
				pm_qos = <0x23 0x24 0x25>;
			};
			pd_crypto@13 {
				reg = <0xd>;
				clocks = <0x2 0xa6 0x2 0xcb 0x2 0x38 0x2 0x39>;  /* 0x2->&{/clock-controller@ff490000}, 0xa6->&{/pinctrl/sdmmc0/sdmmc0-cmd}, 0x2->&{/clock-controller@ff490000}, 0xcb->&{/firmware/optee}, 0x2->&{/clock-controller@ff490000}, 0x38->&{/clock-controller@ff480000}, 0x2->&{/clock-controller@ff490000}, 0x39->&{/pinctrl/i2c0/i2c0-xfer} */
				pm_qos = <0x26>;
			};
			pd_vi@9 {
				reg = <0x9>;
				clocks = <0x2 0xb4 0x2 0xdd 0x2 0x5f 0x2 0xb5 0x2 0xde 0x2 0x9b 0x2 0x63 0x2 0x67 0x2 0x114 0x2 0xb6 0x2 0xdf 0x2 0x9c>;  /* 0x2->&{/clock-controller@ff490000}, 0xb4->&{/pinctrl/pcfg-pull-up-drv-level-2}, 0x2->&{/clock-controller@ff490000}, 0xdd->&{/power-management@ff3e0000}, 0x2->&{/clock-controller@ff490000}, 0x5f->&{/pinctrl/uart4/uart4m0-xfer}, 0x2->&{/clock-controller@ff490000}, 0xb5->&{/pinctrl/pcfg-pull-up}, 0x2->&{/clock-controller@ff490000}, 0xde->&{/i2c@ff3f0000}, 0x2->&{/clock-controller@ff490000}, 0x9b->&{/ethernet@ffc40000/rx-queues-config}, 0x2->&{/clock-controller@ff490000}, 0x63->&{/pinctrl/uart5/uart5m0-ctsn}, 0x2->&{/clock-controller@ff490000}, 0x67->&{/pinctrl/spi1/spi1m0-pins}, 0x2->&{/clock-controller@ff490000}, 0x114->&{/rkispp-vir0}, 0x2->&{/clock-controller@ff490000}, 0xb6->&{/pinctrl/pcfg-pull-down}, 0x2->&{/clock-controller@ff490000}, 0xdf->&{/i2c@ff400000}, 0x2->&{/clock-controller@ff490000}, 0x9c->&{/ethernet@ffc40000/tx-queues-config} */
				pm_qos = <0x27 0x28 0x29>;
			};
			pd_vo@10 {
				reg = <0xa>;
				clocks = <0x2 0xae 0x2 0xd9 0x2 0x5a 0x2 0xaf 0x2 0xda 0x2 0x9a 0x2 0x112 0x2 0xb0 0x2 0xdb 0x2 0x5b>;  /* 0x2->&{/clock-controller@ff490000}, 0xae->&{/otp@ff5c0000/npu-performance@1f}, 0x2->&{/clock-controller@ff490000}, 0xd9->&{/external-gmac-clockm0}, 0x2->&{/clock-controller@ff490000}, 0x5a->&{/pinctrl/uart0/uart0-xfer}, 0x2->&{/clock-controller@ff490000}, 0xaf->&{/usb2-phy@ff4c0000/otg-port}, 0x2->&{/clock-controller@ff490000}, 0xda->&{/external-gmac-clockm1}, 0x2->&{/clock-controller@ff490000}, 0x9a->&{/ethernet@ffc40000/stmmac-axi-config}, 0x2->&{/clock-controller@ff490000}, 0x112->&{/rkisp-vir1}, 0x2->&{/clock-controller@ff490000}, 0xb0->&{/usb2-phy@ff4c0000}, 0x2->&{/clock-controller@ff490000}, 0xdb->&{/syscon@fe000000/rgb}, 0x2->&{/clock-controller@ff490000}, 0x5b->&{/pinctrl/uart0/uart0-ctsn} */
				pm_qos = <0x2a 0x2b 0x2c 0x2d>;
			};
			pd_ispp@11 {
				reg = <0xb>;
				clocks = <0x2 0xba 0x2 0xe1 0x2 0x6b>;  /* 0x2->&{/clock-controller@ff490000}, 0xba->&{/pinctrl/pcfg-output-low}, 0x2->&{/clock-controller@ff490000}, 0xe1->&{/pwm@ff430000}, 0x2->&{/clock-controller@ff490000}, 0x6b->&{/otp@ff5c0000/tsadc-trim-base@27} */
				pm_qos = <0x2e 0x2f>;
			};
			pd_vdpu@12 {
				reg = <0xc>;
				clocks = <0x2 0xab 0x2 0xd6 0x2 0x57 0x2 0x58 0x2 0x59 0x2 0xac 0x2 0xd7>;  /* 0x2->&{/clock-controller@ff490000}, 0xab->&{/pinctrl/sdio/sdio-bus4}, 0x2->&{/clock-controller@ff490000}, 0xd6->&{/thermal-zones/npu-thermal}, 0x2->&{/clock-controller@ff490000}, 0x57->&{/pinctrl/pwm9/pwm9m1-pins}, 0x2->&{/clock-controller@ff490000}, 0x58->&{/pinctrl/pwm10/pwm10m0-pins}, 0x2->&{/clock-controller@ff490000}, 0x59->&{/pinctrl/pwm11/pwm11m0-pins}, 0x2->&{/clock-controller@ff490000}, 0xac->&{/npu-opp-table}, 0x2->&{/clock-controller@ff490000}, 0xd7->&{/oscillator} */
				pm_qos = <0x30 0x31>;
			};
			pd_nvm@15 {
				reg = <0xf>;
				clocks = <0x2 0xe8 0x2 0x72 0x2 0xe9 0x2 0x75 0x2 0xea 0x2 0xeb 0x2 0x76>;  /* 0x2->&{/clock-controller@ff490000}, 0xe8->&{/pwm@ff440030}, 0x2->&{/clock-controller@ff490000}, 0x72->&{/pinctrl/i2s1/i2s1m0-sdi}, 0x2->&{/clock-controller@ff490000}, 0xe9->&{/spi@ff450000}, 0x2->&{/clock-controller@ff490000}, 0x75->&{/pinctrl/i2s2/i2s2m0-lrck}, 0x2->&{/clock-controller@ff490000}, 0xea->&{/csi-dphy@ff4b0000}, 0x2->&{/clock-controller@ff490000}, 0xeb->&{/csi-dphy@ff4b8000}, 0x2->&{/clock-controller@ff490000}, 0x76->&{/pinctrl/i2s2/i2s2m0-sdi} */
				pm_qos = <0x32 0x33 0x34>;
			};
			pd_sdio@16 {
				reg = <0x10>;
				clocks = <0x2 0xe6 0x2 0x6f>;  /* 0x2->&{/clock-controller@ff490000}, 0xe6->&{/pwm@ff440010}, 0x2->&{/clock-controller@ff490000}, 0x6f->&{/otp@ff5c0000/npu-tsadc-trim-h@26} */
				pm_qos = <0x35>;
			};
			pd_usb@17 {
				reg = <0x11>;
				clocks = <0x2 0xed 0x2 0xee 0x2 0x77 0x2 0xbd 0x2 0x78>;  /* 0x2->&{/clock-controller@ff490000}, 0xed->&{/crypto@ff500000}, 0x2->&{/clock-controller@ff490000}, 0xee->&{/i2c@ff510000}, 0x2->&{/clock-controller@ff490000}, 0x77->&{/pinctrl/i2s2/i2s2m0-sdo}, 0x2->&{/clock-controller@ff490000}, 0xbd->&{/pinctrl/pcfg-pull-up-drv-level-1}, 0x2->&{/clock-controller@ff490000}, 0x78->&{/pinctrl/pdm/pdmm0-clk} */
				pm_qos = <0x36 0x37>;
			};
		};
	};
	i2c@ff3f0000 {
		compatible = "rockchip,rv1126-i2c", "rockchip,rk3399-i2c";
		reg = <0xff3f0000 0x1000>;
		interrupts = <0x0 0x4 0x4>;
		#address-cells = <0x1>;
		#size-cells = "", "", "", "";
		clocks = <0x38 0xc 0x38 0x21>;  /* 0x38->&{/clock-controller@ff480000}, 0xc->&{/cpus/cpu@f02}, 0x38->&{/clock-controller@ff480000}, 0x21->&{/vcc-1v8} */
		clock-names = "i2c", "pclk";
		pinctrl-names = "default";
		pinctrl-0 = <&{/pinctrl/i2c0/i2c0-xfer}>;
		status = "okay";
		phandle = <0xde>;
		es7202@30 {
			status = "okay";
			#sound-dai-cells = "", "", "", "";
			compatible = "ES7202_PDM_ADC_1";
			reg = <0x30>;
			phandle = <0xc5>;
		};
	};
	i2c@ff400000 {
		compatible = "rockchip,rv1126-i2c", "rockchip,rk3399-i2c";
		reg = <0xff400000 0x1000>;
		interrupts = <0x0 0x6 0x4>;
		#address-cells = <0x1>;
		#size-cells = "", "", "", "";
		rockchip,grf = <0x3a>;
		clocks = <0x38 0xd 0x38 0x22>;  /* 0x38->&{/clock-controller@ff480000}, 0xd->&{/cpus/cpu@f03}, 0x38->&{/clock-controller@ff480000}, 0x22->&{/qos@fe850000} */
		clock-names = "i2c", "pclk";
		pinctrl-names = "default";
		pinctrl-0 = <&{/pinctrl/i2c2/i2c2-xfer}>;
		status = "disabled";
		phandle = <0xdf>;
	};
	amba {
		compatible = "simple-bus";
		#address-cells = <0x1>;
		#size-cells = <0x1>;
		ranges;
		dma-controller@ff4e0000 {
			compatible = "arm,pl330", "arm,primecell";
			reg = <0xff4e0000 0x4000>;
			interrupts = <0x0 0x1 0x4 0x0 0x2 0x4>;
			#dma-cells = <0x1>;
			clocks = <0x2 0xa1>;  /* 0x2->&{/clock-controller@ff490000}, 0xa1->&{/ethernet@ffc40000/mdio/phy@0} */
			clock-names = "apb_pclk";
			arm,pl330-periph-burst;
			phandle = <0x3c>;
		};
	};
	serial@ff410000 {
		compatible = "rockchip,rv1126-uart", "snps,dw-apb-uart";
		reg = <0xff410000 0x100>;
		interrupts = <0x0 0xd 0x4>;
		reg-shift = <0x2>;
		reg-io-width = <0x4>;
		dmas = <0x3c 0x7 0x3c 0x6>;  /* 0x3c->&{/amba/dma-controller@ff4e0000}, 0x7->&{/otp@ff5c0000/cpu-performance@1e}, 0x3c->&{/amba/dma-controller@ff4e0000}, 0x6->&{/otp@ff5c0000/cpu-leakage@17} */
		clock-frequency = <0x16e3600>;
		clocks = <0x38 0xb 0x38 0x20>;  /* 0x38->&{/clock-controller@ff480000}, 0xb->&{/cpus/cpu@f01}, 0x38->&{/clock-controller@ff480000}, 0x20->&{/vcc33sys} */
		clock-names = "baudclk", "apb_pclk";
		pinctrl-names = "default";
		pinctrl-0 = <0x3d 0x3e 0x3f>;  /* 0x3d->&{/pinctrl/uart1/uart1m0-xfer}, 0x3e->&{/pinctrl/uart1/uart1m0-ctsn}, 0x3f->&{/pinctrl/uart1/uart1m0-rtsn} */
		status = "disabled";
		phandle = <0xe0>;
	};
	pwm@ff430000 {
		compatible = "rockchip,rv1126-pwm", "rockchip,rk3328-pwm";
		reg = <0xff430000 0x10>;
		#pwm-cells = <0x3>;
		pinctrl-names = "active";
		pinctrl-0 = <&{/pinctrl/pwm-pull-down/pwm0m0-pins}>;
		clocks = <0x38 0xf 0x38 0x23>;  /* 0x38->&{/clock-controller@ff480000}, 0xf->&{/reserved-memory/drm-logo@00000000}, 0x38->&{/clock-controller@ff480000}, 0x23->&{/qos@fe870000} */
		clock-names = "pwm", "pclk";
		status = "disabled";
		phandle = <0xe1>;
	};
	pwm@ff430010 {
		compatible = "rockchip,rv1126-pwm", "rockchip,rk3328-pwm";
		reg = <0xff430010 0x10>;
		#pwm-cells = <0x3>;
		pinctrl-names = "active";
		pinctrl-0 = <&{/pinctrl/pwm-pull-down/pwm1m0-pins}>;
		clocks = <0x38 0xf 0x38 0x23>;  /* 0x38->&{/clock-controller@ff480000}, 0xf->&{/reserved-memory/drm-logo@00000000}, 0x38->&{/clock-controller@ff480000}, 0x23->&{/qos@fe870000} */
		clock-names = "pwm", "pclk";
		status = "disabled";
		phandle = <0xe2>;
	};
	pwm@ff430020 {
		compatible = "rockchip,rv1126-pwm", "rockchip,rk3328-pwm";
		reg = <0xff430020 0x10>;
		#pwm-cells = <0x3>;
		pinctrl-names = "active";
		pinctrl-0 = <&{/pinctrl/pwm2/pwm2m0-pins}>;
		clocks = <0x38 0xf 0x38 0x23>;  /* 0x38->&{/clock-controller@ff480000}, 0xf->&{/reserved-memory/drm-logo@00000000}, 0x38->&{/clock-controller@ff480000}, 0x23->&{/qos@fe870000} */
		clock-names = "pwm", "pclk";
		status = "disabled";
		phandle = <0xe3>;
	};
	pwm@ff430030 {
		compatible = "rockchip,rv1126-pwm", "rockchip,rk3328-pwm";
		reg = <0xff430030 0x10>;
		#pwm-cells = <0x3>;
		pinctrl-names = "active";
		pinctrl-0 = <&{/pinctrl/pwm3/pwm3m0-pins}>;
		clocks = <0x38 0xf 0x38 0x23>;  /* 0x38->&{/clock-controller@ff480000}, 0xf->&{/reserved-memory/drm-logo@00000000}, 0x38->&{/clock-controller@ff480000}, 0x23->&{/qos@fe870000} */
		clock-names = "pwm", "pclk";
		status = "disabled";
		phandle = <0xe4>;
	};
	pwm@ff440000 {
		compatible = "rockchip,rv1126-pwm", "rockchip,rk3328-pwm";
		reg = <0xff440000 0x10>;
		#pwm-cells = <0x3>;
		pinctrl-names = "active";
		pinctrl-0 = <&{/pinctrl/pwm4/pwm4m0-pins}>;
		clocks = <0x38 0x11 0x38 0x24>;  /* 0x38->&{/clock-controller@ff480000}, 0x11->&{/vop@ffb00000/port/endpoint@0}, 0x38->&{/clock-controller@ff480000}, 0x24->&{/qos@fe870080} */
		clock-names = "pwm", "pclk";
		status = "disabled";
		phandle = <0xe5>;
	};
	pwm@ff440010 {
		compatible = "rockchip,rv1126-pwm", "rockchip,rk3328-pwm";
		reg = <0xff440010 0x10>;
		#pwm-cells = <0x3>;
		pinctrl-names = "active";
		pinctrl-0 = <&{/pinctrl/pwm5/pwm5m0-pins}>;
		clocks = <0x38 0x11 0x38 0x24>;  /* 0x38->&{/clock-controller@ff480000}, 0x11->&{/vop@ffb00000/port/endpoint@0}, 0x38->&{/clock-controller@ff480000}, 0x24->&{/qos@fe870080} */
		clock-names = "pwm", "pclk";
		status = "disabled";
		phandle = <0xe6>;
	};
	pwm@ff440020 {
		compatible = "rockchip,rv1126-pwm", "rockchip,rk3328-pwm";
		reg = <0xff440020 0x10>;
		#pwm-cells = <0x3>;
		pinctrl-names = "active";
		pinctrl-0 = <&{/pinctrl/pwm6/pwm6m0-pins}>;
		clocks = <0x38 0x11 0x38 0x24>;  /* 0x38->&{/clock-controller@ff480000}, 0x11->&{/vop@ffb00000/port/endpoint@0}, 0x38->&{/clock-controller@ff480000}, 0x24->&{/qos@fe870080} */
		clock-names = "pwm", "pclk";
		status = "disabled";
		phandle = <0xe7>;
	};
	pwm@ff440030 {
		compatible = "rockchip,rv1126-pwm", "rockchip,rk3328-pwm";
		reg = <0xff440030 0x10>;
		#pwm-cells = <0x3>;
		pinctrl-names = "active";
		pinctrl-0 = <&{/pinctrl/pwm7/pwm7m0-pins}>;
		clocks = <0x38 0x11 0x38 0x24>;  /* 0x38->&{/clock-controller@ff480000}, 0x11->&{/vop@ffb00000/port/endpoint@0}, 0x38->&{/clock-controller@ff480000}, 0x24->&{/qos@fe870080} */
		clock-names = "pwm", "pclk";
		status = "disabled";
		phandle = <0xe8>;
	};
	spi@ff450000 {
		compatible = "rockchip,rv1126-spi", "rockchip,rk3066-spi";
		reg = <0xff450000 0x1000>;
		interrupts = <0x0 0xa 0x4>;
		#address-cells = <0x1>;
		#size-cells = "", "", "", "";
		clocks = <0x38 0x12 0x38 0x25>;  /* 0x38->&{/clock-controller@ff480000}, 0x12->&{/rkcif@ffae0000}, 0x38->&{/clock-controller@ff480000}, 0x25->&{/qos@fe870100} */
		clock-names = "spiclk", "apb_pclk";
		dmas = <0x3c 0x1 0x3c 0x0>;  /* 0x3c->&{/amba/dma-controller@ff4e0000}, 0x1->&{/interrupt-controller@feff0000}, 0x3c->&{/amba/dma-controller@ff4e0000} */
		dma-names = "tx", "rx";
		pinctrl-names = "default", "high_speed";
		status = "disabled";
		phandle = <0xe9>;
	};
	pvtm@ff470000 {
		compatible = "rockchip,rv1126-pmu-pvtm";
		reg = <0xff470000 0x100>;
		#address-cells = <0x1>;
		#size-cells = "", "", "", "";
		pvtm@2 {
			reg = <0x2>;
			clocks = <0x38 0x14 0x38 0x2c>;  /* 0x38->&{/clock-controller@ff480000}, 0x14->&{/rkcif_dvp}, 0x38->&{/clock-controller@ff480000}, 0x2c->&{/qos@fe8a0180} */
			clock-names = "clk", "pclk";
			resets = <0x38 0x18 0x38 0x19>;  /* 0x38->&{/clock-controller@ff480000}, 0x18->&{/mipi-csi2@ffb10000/ports/port@1/endpoint@0}, 0x38->&{/clock-controller@ff480000}, 0x19->&{/rkcif_mipi_lvds} */
			reset-names = "rst", "rst-p";
		};
	};
	clock-controller@ff480000 {
		compatible = "rockchip,rv1126-pmucru";
		reg = <0xff480000 0x1000>;
		rockchip,pmugrf = <0x3a>;
		#clock-cells = <0x1>;
		#reset-cells = <0x1>;
		phandle = <0x38>;
	};
	clock-controller@ff490000 {
		compatible = "rockchip,rv1126-cru";
		reg = <0xff490000 0x1000>;
		rockchip,grf = <0x48>;
		#clock-cells = <0x1>;
		#reset-cells = <0x1>;
		assigned-clocks = <0x38 0x3 0x38 0x1 0x38 0x1e 0x2 0x3 0x2 0x4 0x2 0x5 0x2 0xa0 0x2 0xec 0x2 0xf6 0x2 0xbb 0x2 0xe2 0x2 0xcc 0x2 0xc8>;  /* 0x38->&{/clock-controller@ff480000}, 0x3->&{/cpu0-opp-table}, 0x38->&{/clock-controller@ff480000}, 0x1->&{/interrupt-controller@feff0000}, 0x38->&{/clock-controller@ff480000}, 0x1e->&{/rkvenc@ffbb0000}, 0x2->&{/clock-controller@ff490000}, 0x3->&{/cpu0-opp-table}, 0x2->&{/clock-controller@ff490000}, 0x4->&{/cpus/idle-states/cpu-sleep}, 0x2->&{/clock-controller@ff490000}, 0x5->&{/vdd-arm-logic-npu-vepu-fixed}, 0x2->&{/clock-controller@ff490000}, 0xa0->&{/pinctrl/gmac_clk/gmac-clk-m0-pins}, 0x2->&{/clock-controller@ff490000}, 0xec->&{/rng@ff500400}, 0x2->&{/clock-controller@ff490000}, 0xf6->&{/pwm@ff550000}, 0x2->&{/clock-controller@ff490000}, 0xbb->&{/pinctrl/pcfg-pull-none-drv-level-3}, 0x2->&{/clock-controller@ff490000}, 0xe2->&{/pwm@ff430010}, 0x2->&{/clock-controller@ff490000}, 0xcc->&{/reserved-memory/ramoops@8000000}, 0x2->&{/clock-controller@ff490000}, 0xc8->&{/display-subsystem/route/route-dsi} */
		assigned-clock-rates = <0x8000 0x46cf7100 0x5f5e100 0x1dcd6500 0x53724e00 0x23c34600 0x1dcd6500 0xbebc200 0x5f5e100 0x11e1a300 0xbebc200 0x8f0d180 0xbebc200>;
		assigned-clock-parents = <0x38 0x2>;  /* 0x38->&{/clock-controller@ff480000}, 0x2->&{/clock-controller@ff490000} */
		phandle = <0x2>;
	};
	csi-dphy@ff4b0000 {
		compatible = "rockchip,rv1126-csi-dphy";
		reg = <0xff4b0000 0x8000>;
		clocks = <0x2 0x122>;  /* 0x2->&{/clock-controller@ff490000}, 0x122->&{/usb0/dwc3@ffd00000} */
		clock-names = "pclk";
		rockchip,grf = <0x48>;
		status = "okay";
		phandle = <0xea>;
		ports {
			#address-cells = <0x1>;
			#size-cells = "", "", "", "";
			port@0 {
				reg = "", "", "", "";
				#address-cells = <0x1>;
				#size-cells = "", "", "", "";
				endpoint@1 {
					reg = <0x1>;
					remote-endpoint = <&{/i2c@ff510000/sc5338@30/port/endpoint}>;
					data-lanes = <0x1 0x2>;
					phandle = <0x52>;
				};
			};
			port@1 {
				reg = <0x1>;
				#address-cells = <0x1>;
				#size-cells = "", "", "", "";
				endpoint@0 {
					reg = "", "", "", "";
					remote-endpoint = <&{/mipi-csi2@ffb10000/ports/port@0/endpoint@1}>;
					data-lanes = <0x1 0x2>;
					phandle = <0x84>;
				};
			};
		};
	};
	csi-dphy@ff4b8000 {
		compatible = "rockchip,rv1126-csi-dphy";
		reg = <0xff4b8000 0x8000>;
		clocks = <0x2 0x123>;  /* 0x2->&{/clock-controller@ff490000}, 0x123->&{/usb@ffe00000} */
		clock-names = "pclk";
		rockchip,grf = <0x48>;
		status = "disabled";
		phandle = <0xeb>;
	};
	usb2-phy@ff4c0000 {
		compatible = "rockchip,rv1126-usb2phy";
		reg = <0xff4c0000 0x8000>;
		rockchip,grf = <0x48>;
		clocks = <0x38 0x17 0x2 0x125>;  /* 0x38->&{/clock-controller@ff480000}, 0x17->&{/rkcif_lite_mipi_lvds}, 0x2->&{/clock-controller@ff490000}, 0x125->&{/pinctrl} */
		clock-names = "phyclk", "pclk";
		resets = <0x2 0xb8 0x2 0xb6>;  /* 0x2->&{/clock-controller@ff490000}, 0xb8->&{/pinctrl/pcfg-pull-none-drv-level-8}, 0x2->&{/clock-controller@ff490000}, 0xb6->&{/pinctrl/pcfg-pull-down} */
		reset-names = "u2phy", "u2phy-apb";
		#clock-cells = "", "", "", "";
		status = "okay";
		vup-gpios = <0x4b 0x11 0x1>;
		phandle = <0xb0>;
		otg-port {
			#phy-cells = "", "", "", "";
			interrupts = <0x0 0x73 0x4 0x0 0x74 0x4 0x0 0x75 0x4 0x0 0x78 0x4>;
			interrupt-names = "otg-bvalid", "otg-id", "linestate", "disconnect";
			status = "okay";
			phandle = <0xaf>;
		};
	};
	usb2-phy@ff4c8000 {
		compatible = "rockchip,rv1126-usb2phy";
		reg = <0xff4c8000 0x8000>;
		rockchip,grf = <0x48>;
		clocks = <0x38 0x18 0x2 0x124>;  /* 0x38->&{/clock-controller@ff480000}, 0x18->&{/mipi-csi2@ffb10000/ports/port@1/endpoint@0}, 0x2->&{/clock-controller@ff490000}, 0x124->&{/usb@ffe10000} */
		clock-names = "phyclk", "pclk";
		assigned-clocks = <0x2 0x6>;  /* 0x2->&{/clock-controller@ff490000}, 0x6->&{/otp@ff5c0000/cpu-leakage@17} */
		assigned-clock-parents = <&{/usb2-phy@ff4c8000}>;
		resets = <0x2 0xb9 0x2 0xb7>;  /* 0x2->&{/clock-controller@ff490000}, 0xb9->&{/pinctrl/pcfg-pull-none-drv-level-2}, 0x2->&{/clock-controller@ff490000}, 0xb7->&{/pinctrl/pcfg-pull-none-drv-level-0-smt} */
		reset-names = "u2phy", "u2phy-apb";
		#clock-cells = "", "", "", "";
		clock-output-names = "usb480m_phy";
		status = "disabled";
		phandle = <0x4c>;
		host-port {
			#phy-cells = "", "", "", "";
			interrupts = <0x0 0x76 0x4 0x0 0x77 0x4>;
			interrupt-names = "linestate", "disconnect";
			status = "disabled";
			phandle = <0xb1>;
		};
	};
	mipi-dphy@ff4d0000 {
		compatible = "rockchip,rv1126-mipi-dphy", "rockchip,rk1808-mipi-dphy";
		reg = <0xff4d0000 0x500>;
		assigned-clocks = <0x38 0x1a>;  /* 0x38->&{/clock-controller@ff480000}, 0x1a->&{/rkisp-vir0/ports/port@0/endpoint@0} */
		assigned-clock-rates = <0x16e3600>;
		clocks = <0x38 0x1a 0x2 0x121>;  /* 0x38->&{/clock-controller@ff480000}, 0x1a->&{/rkisp-vir0/ports/port@0/endpoint@0}, 0x2->&{/clock-controller@ff490000}, 0x121->&{/usb0} */
		clock-names = "ref", "pclk";
		clock-output-names = "mipi_dphy_pll";
		#clock-cells = "", "", "", "";
		resets = <0x2 0xe6>;  /* 0x2->&{/clock-controller@ff490000}, 0xe6->&{/pwm@ff440010} */
		reset-names = "apb";
		#phy-cells = "", "", "", "";
		rockchip,grf = <0x48>;
		status = "disabled";
		phandle = <0x88>;
	};
	rng@ff500400 {
		compatible = "rockchip,cryptov2-rng";
		reg = <0xff500400 0x80>;
		clocks = <0x2 0xcb>;  /* 0x2->&{/clock-controller@ff490000}, 0xcb->&{/firmware/optee} */
		clock-names = "hclk_crypto";
		power-domains = <0x4d 0xd>;  /* 0x4d->&{/power-management@ff3e0000/power-controller}, 0xd->&{/cpus/cpu@f03} */
		resets = <0x2 0x5c>;  /* 0x2->&{/clock-controller@ff490000}, 0x5c->&{/pinctrl/uart0/uart0-rtsn} */
		reset-names = "reset";
		status = "okay";
		phandle = <0xec>;
	};
	crypto@ff500000 {
		compatible = "rockchip,rv1126-crypto";
		reg = <0xff500000 0x400 0xff500480 0x3b80>;
		interrupts = <0x0 0x3 0x4>;
		clocks = <0x2 0x38 0x2 0x39 0x2 0xa6 0x2 0xcb>;  /* 0x2->&{/clock-controller@ff490000}, 0x38->&{/clock-controller@ff480000}, 0x2->&{/clock-controller@ff490000}, 0x39->&{/pinctrl/i2c0/i2c0-xfer}, 0x2->&{/clock-controller@ff490000}, 0xa6->&{/pinctrl/sdmmc0/sdmmc0-cmd}, 0x2->&{/clock-controller@ff490000}, 0xcb->&{/firmware/optee} */
		clock-names = "aclk", "hclk", "sclk", "apb_pclk";
		power-domains = <0x4d 0xd>;  /* 0x4d->&{/power-management@ff3e0000/power-controller}, 0xd->&{/cpus/cpu@f03} */
		resets = <0x2 0x5c>;  /* 0x2->&{/clock-controller@ff490000}, 0x5c->&{/pinctrl/uart0/uart0-rtsn} */
		reset-names = "crypto-rst";
		status = "disabled";
		phandle = <0xed>;
	};
	i2c@ff510000 {
		compatible = "rockchip,rv1126-i2c", "rockchip,rk3399-i2c";
		reg = <0xff510000 0x1000>;
		interrupts = <0x0 0x5 0x4>;
		#address-cells = <0x1>;
		#size-cells = "", "", "", "";
		clocks = <0x2 0x21 0x2 0xff>;  /* 0x2->&{/clock-controller@ff490000}, 0x21->&{/vcc-1v8}, 0x2->&{/clock-controller@ff490000}, 0xff->&{/spi@ff5b0000} */
		clock-names = "i2c", "pclk";
		pinctrl-names = "default";
		pinctrl-0 = <&{/pinctrl/i2c1/i2c1-xfer}>;
		status = "okay";
		clock-frequency = <0x61a80>;
		phandle = <0xee>;
		sc5338@30 {
			compatible = "smartsens,sc5338";
			reg = <0x30>;
			clocks = <0x2 0x67>;  /* 0x2->&{/clock-controller@ff490000}, 0x67->&{/pinctrl/spi1/spi1m0-pins} */
			clock-names = "xvclk";
			power-domains = <0x4d 0x9>;  /* 0x4d->&{/power-management@ff3e0000/power-controller}, 0x9->&{/otp@ff5c0000/cpu-code@2} */
			pinctrl-names = "rockchip,camera_default";
			pinctrl-0 = <&{/pinctrl/mipicsi/mipicsi-clk0}>;
			avdd-supply = <&{/vcc33sys}>;
			dovdd-supply = <&{/vcc-1v8}>;
			dvdd-supply = <&{/vcc-dvdd}>;
			pwdn-gpios = <0x51 0x1c 0x0>;
			reset-gpios = <0x51 0x1d 0x0>;
			rockchip,camera-module-index = <0x1>;
			rockchip,camera-module-facing = "front";
			rockchip,camera-module-name = "CMK-OT1607-FV1";
			rockchip,camera-module-lens-name = "M12-40IRC-4MP-F16";
			phandle = <0xef>;
			port {
				endpoint {
					remote-endpoint = <&{/csi-dphy@ff4b0000/ports/port@0/endpoint@1}>;
					data-lanes = <0x1 0x2>;
					phandle = <0x49>;
				};
			};
		};
		sc530ai@30 {
			compatible = "smartsens,sc530ai";
			reg = <0x30>;
			clocks = <0x2 0x67>;  /* 0x2->&{/clock-controller@ff490000}, 0x67->&{/pinctrl/spi1/spi1m0-pins} */
			clock-names = "xvclk";
			power-domains = <0x4d 0x9>;  /* 0x4d->&{/power-management@ff3e0000/power-controller}, 0x9->&{/otp@ff5c0000/cpu-code@2} */
			pinctrl-names = "rockchip,camera_default";
			pinctrl-0 = <&{/pinctrl/mipicsi/mipicsi-clk0}>;
			avdd-supply = <&{/vcc33sys}>;
			dovdd-supply = <&{/vcc-1v8}>;
			dvdd-supply = <&{/vcc-dvdd}>;
			pwdn-gpios = <0x51 0x1c 0x0>;
			reset-gpios = <0x51 0x1d 0x0>;
			rockchip,camera-module-index = <0x1>;
			rockchip,camera-module-facing = "front";
			rockchip,camera-module-name = "CMK-OT1607-FV1";
			rockchip,camera-module-lens-name = "M12-40IRC-4MP-F16";
			phandle = <0xf0>;
		};
		sc401ai@30 {
			compatible = "smartsens,sc401ai";
			reg = <0x30>;
			clocks = <0x2 0x67>;  /* 0x2->&{/clock-controller@ff490000}, 0x67->&{/pinctrl/spi1/spi1m0-pins} */
			clock-names = "xvclk";
			power-domains = <0x4d 0x9>;  /* 0x4d->&{/power-management@ff3e0000/power-controller}, 0x9->&{/otp@ff5c0000/cpu-code@2} */
			pinctrl-names = "rockchip,camera_default";
			pinctrl-0 = <&{/pinctrl/mipicsi/mipicsi-clk0}>;
			avdd-supply = <&{/vcc33sys}>;
			dovdd-supply = <&{/vcc-1v8}>;
			dvdd-supply = <&{/vcc-dvdd}>;
			pwdn-gpios = <0x51 0x1c 0x0>;
			reset-gpios = <0x51 0x1d 0x0>;
			rockchip,camera-module-index = <0x1>;
			rockchip,camera-module-facing = "front";
			rockchip,camera-module-name = "CMK-OT1607-FV1";
			rockchip,camera-module-lens-name = "M12-40IRC-4MP-F16";
			phandle = <0xf1>;
		};
	};
	i2c@ff520000 {
		compatible = "rockchip,rv1126-i2c", "rockchip,rk3399-i2c";
		reg = <0xff520000 0x1000>;
		interrupts = <0x0 0x7 0x4>;
		#address-cells = <0x1>;
		#size-cells = "", "", "", "";
		clocks = <0x2 0x22 0x2 0x100>;  /* 0x2->&{/clock-controller@ff490000}, 0x22->&{/qos@fe850000}, 0x2->&{/clock-controller@ff490000}, 0x100->&{/otp@ff5c0000} */
		clock-names = "i2c", "pclk";
		pinctrl-names = "default";
		pinctrl-0 = <&{/pinctrl/i2c3/i2c3m0-xfer}>;
		status = "disabled";
		phandle = <0xf2>;
	};
	i2c@ff530000 {
		compatible = "rockchip,rv1126-i2c", "rockchip,rk3399-i2c";
		reg = <0xff530000 0x1000>;
		interrupts = <0x0 0x8 0x4>;
		#address-cells = <0x1>;
		#size-cells = "", "", "", "";
		clocks = <0x2 0x23 0x2 0x101>;  /* 0x2->&{/clock-controller@ff490000}, 0x23->&{/qos@fe870000}, 0x2->&{/clock-controller@ff490000}, 0x101->&{/otp@ff5c0000/logic-leakage@18} */
		clock-names = "i2c", "pclk";
		pinctrl-names = "default";
		pinctrl-0 = <&{/pinctrl/i2c4/i2c4m0-xfer}>;
		status = "okay";
		clock-frequency = <0x186a0>;
		phandle = <0xf3>;
		pcf8563@51 {
			status = "okay";
			compatible = "pcf8563";
			reg = <0x51>;
			#clock-cells = "", "", "", "";
			clock-frequency = <0x8000>;
			clock-output-names = "xin32k";
			phandle = <0xf4>;
		};
	};
	i2c@ff540000 {
		compatible = "rockchip,rv1126-i2c", "rockchip,rk3399-i2c";
		reg = <0xff540000 0x1000>;
		interrupts = <0x0 0x9 0x4>;
		#address-cells = <0x1>;
		#size-cells = "", "", "", "";
		clocks = <0x2 0x24 0x2 0x102>;  /* 0x2->&{/clock-controller@ff490000}, 0x24->&{/qos@fe870080}, 0x2->&{/clock-controller@ff490000}, 0x102->&{/can@ff610000} */
		clock-names = "i2c", "pclk";
		pinctrl-names = "default";
		pinctrl-0 = <&{/pinctrl/i2c5/i2c5m0-xfer}>;
		status = "disabled";
		phandle = <0xf5>;
	};
	pwm@ff550000 {
		compatible = "rockchip,rv1126-pwm", "rockchip,rk3328-pwm";
		reg = <0xff550000 0x10>;
		#pwm-cells = <0x3>;
		pinctrl-names = "active";
		pinctrl-0 = <&{/pinctrl/pwm8/pwm8m1-pins}>;
		clocks = <0x2 0x27 0x2 0x105>;  /* 0x2->&{/clock-controller@ff490000}, 0x27->&{/qos@fe890000}, 0x2->&{/clock-controller@ff490000}, 0x105->&{/mailbox@ff6a0000} */
		clock-names = "pwm", "pclk";
		status = "okay";
		phandle = <0xf6>;
	};
	pwm@ff550010 {
		compatible = "rockchip,rv1126-pwm", "rockchip,rk3328-pwm";
		reg = <0xff550010 0x10>;
		#pwm-cells = <0x3>;
		pinctrl-names = "active";
		pinctrl-0 = <&{/pinctrl/pwm9/pwm9m1-pins}>;
		clocks = <0x2 0x27 0x2 0x105>;  /* 0x2->&{/clock-controller@ff490000}, 0x27->&{/qos@fe890000}, 0x2->&{/clock-controller@ff490000}, 0x105->&{/mailbox@ff6a0000} */
		clock-names = "pwm", "pclk";
		status = "okay";
		phandle = <0xf7>;
	};
	pwm@ff550020 {
		compatible = "rockchip,rv1126-pwm", "rockchip,rk3328-pwm";
		reg = <0xff550020 0x10>;
		#pwm-cells = <0x3>;
		pinctrl-names = "active";
		pinctrl-0 = <&{/pinctrl/pwm10/pwm10m0-pins}>;
		clocks = <0x2 0x27 0x2 0x105>;  /* 0x2->&{/clock-controller@ff490000}, 0x27->&{/qos@fe890000}, 0x2->&{/clock-controller@ff490000}, 0x105->&{/mailbox@ff6a0000} */
		clock-names = "pwm", "pclk";
		status = "disabled";
		phandle = <0xf8>;
	};
	pwm@ff550030 {
		compatible = "rockchip,rv1126-pwm", "rockchip,rk3328-pwm";
		reg = <0xff550030 0x10>;
		#pwm-cells = <0x3>;
		pinctrl-names = "active";
		pinctrl-0 = <&{/pinctrl/pwm11/pwm11m0-pins}>;
		clocks = <0x2 0x27 0x2 0x105>;  /* 0x2->&{/clock-controller@ff490000}, 0x27->&{/qos@fe890000}, 0x2->&{/clock-controller@ff490000}, 0x105->&{/mailbox@ff6a0000} */
		clock-names = "pwm", "pclk";
		status = "disabled";
		phandle = <0xf9>;
	};
	serial@ff560000 {
		compatible = "rockchip,rv1126-uart", "snps,dw-apb-uart";
		reg = <0xff560000 0x100>;
		interrupts = <0x0 0xc 0x4>;
		reg-shift = <0x2>;
		reg-io-width = <0x4>;
		dmas = <0x3c 0x5 0x3c 0x4>;  /* 0x3c->&{/amba/dma-controller@ff4e0000}, 0x5->&{/vdd-arm-logic-npu-vepu-fixed}, 0x3c->&{/amba/dma-controller@ff4e0000}, 0x4->&{/cpus/idle-states/cpu-sleep} */
		clock-frequency = <0x16e3600>;
		clocks = <0x2 0x10 0x2 0xfa>;  /* 0x2->&{/clock-controller@ff490000}, 0x10->&{/vop@ffb00000/port/endpoint@1}, 0x2->&{/clock-controller@ff490000}, 0xfa->&{/serial@ff560000} */
		clock-names = "baudclk", "apb_pclk";
		pinctrl-names = "default";
		pinctrl-0 = <0x5a 0x5b 0x5c>;  /* 0x5a->&{/pinctrl/uart0/uart0-xfer}, 0x5b->&{/pinctrl/uart0/uart0-ctsn}, 0x5c->&{/pinctrl/uart0/uart0-rtsn} */
		status = "disabled";
		phandle = <0xfa>;
	};
	serial@ff570000 {
		compatible = "rockchip,rv1126-uart", "snps,dw-apb-uart";
		reg = <0xff570000 0x100>;
		interrupts = <0x0 0xe 0x4>;
		reg-shift = <0x2>;
		reg-io-width = <0x4>;
		dmas = <0x3c 0x9 0x3c 0x8>;  /* 0x3c->&{/amba/dma-controller@ff4e0000}, 0x9->&{/otp@ff5c0000/cpu-code@2}, 0x3c->&{/amba/dma-controller@ff4e0000}, 0x8->&{/otp@ff5c0000/id@7} */
		clock-frequency = <0x16e3600>;
		clocks = <0x2 0x14 0x2 0xfb>;  /* 0x2->&{/clock-controller@ff490000}, 0x14->&{/rkcif_dvp}, 0x2->&{/clock-controller@ff490000}, 0xfb->&{/serial@ff570000} */
		clock-names = "baudclk", "apb_pclk";
		pinctrl-names = "default";
		pinctrl-0 = <&{/pinctrl/uart2/uart2m1-xfer}>;
		status = "disabled";
		phandle = <0xfb>;
	};
	serial@ff580000 {
		compatible = "rockchip,rv1126-uart", "snps,dw-apb-uart";
		reg = <0xff580000 0x100>;
		interrupts = <0x0 0xf 0x4>;
		reg-shift = <0x2>;
		reg-io-width = <0x4>;
		dmas = <0x3c 0xb 0x3c 0xa>;  /* 0x3c->&{/amba/dma-controller@ff4e0000}, 0xb->&{/cpus/cpu@f01}, 0x3c->&{/amba/dma-controller@ff4e0000}, 0xa->&{/cpus/cpu@f00} */
		clock-frequency = <0x16e3600>;
		clocks = <0x2 0x18 0x2 0xfc>;  /* 0x2->&{/clock-controller@ff490000}, 0x18->&{/mipi-csi2@ffb10000/ports/port@1/endpoint@0}, 0x2->&{/clock-controller@ff490000}, 0xfc->&{/serial@ff580000} */
		clock-names = "baudclk", "apb_pclk";
		pinctrl-names = "default";
		pinctrl-0 = <&{/pinctrl/uart3/uart3m2-xfer}>;
		status = "disabled";
		phandle = <0xfc>;
	};
	serial@ff590000 {
		compatible = "rockchip,rv1126-uart", "snps,dw-apb-uart";
		reg = <0xff590000 0x100>;
		interrupts = <0x0 0x10 0x4>;
		reg-shift = <0x2>;
		reg-io-width = <0x4>;
		dmas = <0x3c 0xd 0x3c 0xc>;  /* 0x3c->&{/amba/dma-controller@ff4e0000}, 0xd->&{/cpus/cpu@f03}, 0x3c->&{/amba/dma-controller@ff4e0000}, 0xc->&{/cpus/cpu@f02} */
		clock-frequency = <0x16e3600>;
		clocks = <0x2 0x1c 0x2 0xfd>;  /* 0x2->&{/clock-controller@ff490000}, 0x1c->&{/thermal-zones/cpu-thermal/trips/trip-point-1}, 0x2->&{/clock-controller@ff490000}, 0xfd->&{/serial@ff590000} */
		clock-names = "baudclk", "apb_pclk";
		pinctrl-names = "default";
		pinctrl-0 = <0x5f 0x60 0x61>;  /* 0x5f->&{/pinctrl/uart4/uart4m0-xfer}, 0x60->&{/pinctrl/uart4/uart4m0-ctsn}, 0x61->&{/pinctrl/uart4/uart4m0-rtsn} */
		status = "disabled";
		phandle = <0xfd>;
	};
	serial@ff5a0000 {
		compatible = "rockchip,rv1126-uart", "snps,dw-apb-uart";
		reg = <0xff5a0000 0x100>;
		interrupts = <0x0 0x11 0x4>;
		reg-shift = <0x2>;
		reg-io-width = <0x4>;
		dmas = <0x3c 0xf 0x3c 0xe>;  /* 0x3c->&{/amba/dma-controller@ff4e0000}, 0xf->&{/reserved-memory/drm-logo@00000000}, 0x3c->&{/amba/dma-controller@ff4e0000}, 0xe->&{/vop@ffb00000/port} */
		clock-frequency = <0x16e3600>;
		clocks = <0x2 0x20 0x2 0xfe>;  /* 0x2->&{/clock-controller@ff490000}, 0x20->&{/vcc33sys}, 0x2->&{/clock-controller@ff490000}, 0xfe->&{/serial@ff5a0000} */
		clock-names = "baudclk", "apb_pclk";
		pinctrl-names = "default";
		pinctrl-0 = <0x62 0x63 0x64>;  /* 0x62->&{/pinctrl/uart5/uart5m0-xfer}, 0x63->&{/pinctrl/uart5/uart5m0-ctsn}, 0x64->&{/pinctrl/uart5/uart5m0-rtsn} */
		status = "disabled";
		phandle = <0xfe>;
	};
	spi@ff5b0000 {
		compatible = "rockchip,rv1126-spi", "rockchip,rk3066-spi";
		reg = <0xff5b0000 0x1000>;
		interrupts = <0x0 0xb 0x4>;
		#address-cells = <0x1>;
		#size-cells = "", "", "", "";
		clocks = <0x2 0x25 0x2 0x103>;  /* 0x2->&{/clock-controller@ff490000}, 0x25->&{/qos@fe870100}, 0x2->&{/clock-controller@ff490000}, 0x103->&{/rktimer@ff660000} */
		clock-names = "spiclk", "apb_pclk";
		dmas = <0x3c 0x3 0x3c 0x2>;  /* 0x3c->&{/amba/dma-controller@ff4e0000}, 0x3->&{/cpu0-opp-table}, 0x3c->&{/amba/dma-controller@ff4e0000}, 0x2->&{/clock-controller@ff490000} */
		dma-names = "tx", "rx";
		pinctrl-names = "default", "high_speed";
		pinctrl-0 = <0x65 0x66 0x67>;  /* 0x65->&{/pinctrl/spi1/spi1m0-cs0}, 0x66->&{/pinctrl/spi1/spi1m0-cs1}, 0x67->&{/pinctrl/spi1/spi1m0-pins} */
		pinctrl-1 = <0x65 0x66 0x68>;  /* 0x65->&{/pinctrl/spi1/spi1m0-cs0}, 0x66->&{/pinctrl/spi1/spi1m0-cs1}, 0x68->&{/pinctrl/spi1-hs/spi1m0-pins} */
		status = "disabled";
		phandle = <0xff>;
	};
	otp@ff5c0000 {
		compatible = "rockchip,rv1126-otp";
		reg = <0xff5c0000 0x1000>;
		#address-cells = <0x1>;
		#size-cells = <0x1>;
		clocks = <0x2 0x94 0x2 0x126>;  /* 0x2->&{/clock-controller@ff490000}, 0x94->&{/iommu@ffb80480}, 0x2->&{/clock-controller@ff490000}, 0x126->&{/pinctrl/gpio3@ff640000} */
		clock-names = "otp", "apb_pclk";
		status = "okay";
		phandle = <0x100>;
		cpu-code@2 {
			reg = <0x2 0x2>;
			phandle = <0x9>;
		};
		id@7 {
			reg = <0x7 0x10>;
			phandle = <0x8>;
		};
		cpu-leakage@17 {
			reg = <0x17 0x1>;
			phandle = <0x6>;
		};
		logic-leakage@18 {
			reg = <0x18 0x1>;
			phandle = <0x101>;
		};
		npu-leakage@19 {
			reg = <0x19 0x1>;
			phandle = <0xad>;
		};
		venc-leakage@1a {
			reg = <0x1a 0x1>;
			phandle = <0x98>;
		};
		cpu-performance@1e {
			reg = <0x1e 0x1>;
			bits = <0x4 0x3>;
			phandle = <0x7>;
		};
		npu-performance@1f {
			reg = <0x1f 0x1>;
			bits = <0x0 0x2>;
			phandle = <0xae>;
		};
		venc-performance@1f {
			reg = <0x1f 0x1>;
			bits = <0x2 0x2>;
			phandle = <0x99>;
		};
		cpu-tsadc-trim-l@23 {
			reg = <0x23 0x1>;
			phandle = <0x69>;
		};
		cpu-tsadc-trim-h@24 {
			reg = <0x24 0x1>;
			bits = <0x0 0x4>;
			phandle = <0x6a>;
		};
		npu-tsadc-trim-l@25 {
			reg = <0x25 0x1>;
			phandle = <0x6e>;
		};
		npu-tsadc-trim-h@26 {
			reg = <0x26 0x1>;
			bits = <0x0 0x4>;
			phandle = <0x6f>;
		};
		tsadc-trim-base@27 {
			reg = <0x27 0x1>;
			phandle = <0x6b>;
		};
	};
	saradc@ff5e0000 {
		compatible = "rockchip,rk3399-saradc";
		reg = <0xff5e0000 0x100>;
		interrupts = <0x0 0x28 0x4>;
		#io-channel-cells = <0x1>;
		clocks = <0x2 0x2c 0x2 0x10a>;  /* 0x2->&{/clock-controller@ff490000}, 0x2c->&{/qos@fe8a0180}, 0x2->&{/clock-controller@ff490000}, 0x10a->&{/dmc} */
		clock-names = "saradc", "apb_pclk";
		resets = <0x2 0x3b>;  /* 0x2->&{/clock-controller@ff490000}, 0x3b->&{/pinctrl/i2c2/i2c2-xfer} */
		reset-names = "saradc-apb";
		status = "okay";
		vref-supply = <&{/vcc-1v8}>;
		phandle = <0xbf>;
	};
	tsadc@ff5f0000 {
		compatible = "rockchip,rv1126-tsadc";
		reg = <0xff5f0000 0x100>;
		rockchip,grf = <0x48>;
		interrupts = <0x0 0x27 0x4>;
		assigned-clocks = <0x2 0x36>;  /* 0x2->&{/clock-controller@ff490000}, 0x36->&{/qos@fe810000} */
		assigned-clock-rates = <0x3d0900>;
		clocks = <0x2 0x36 0x2 0x10f 0x2 0x37>;  /* 0x2->&{/clock-controller@ff490000}, 0x36->&{/qos@fe810000}, 0x2->&{/clock-controller@ff490000}, 0x10f->&{/iep@ffb20000}, 0x2->&{/clock-controller@ff490000}, 0x37->&{/qos@fe810080} */
		clock-names = "tsadc", "apb_pclk", "phy_clk";
		resets = <0x2 0xe8 0x2 0xe9 0x2 0xea>;  /* 0x2->&{/clock-controller@ff490000}, 0xe8->&{/pwm@ff440030}, 0x2->&{/clock-controller@ff490000}, 0xe9->&{/spi@ff450000}, 0x2->&{/clock-controller@ff490000}, 0xea->&{/csi-dphy@ff4b0000} */
		reset-names = "tsadc-apb", "tsadc", "tsadc-phy";
		rockchip,hw-tshut-temp = <0x1d4c0>;
		#thermal-sensor-cells = <0x1>;
		nvmem-cells = <0x69 0x6a 0x6b>;
		nvmem-cell-names = "trim_l", "trim_h", "trim_base";
		rockchip,hw-tshut-mode = "", "", "", "";
		rockchip,hw-tshut-polarity = "", "", "", "";
		pinctrl-names = "gpio", "otpout";
		pinctrl-0 = <&{/pinctrl/tsadc/tsadcm0-shut}>;
		pinctrl-1 = <&{/pinctrl/tsadc/tsadc-shutorg}>;
		status = "okay";
		phandle = <0x1b>;
	};
	tsadc@ff5f8000 {
		compatible = "rockchip,rv1126-tsadc";
		reg = <0xff5f8000 0x100>;
		rockchip,grf = <0x48>;
		interrupts = <0x0 0x71 0x4>;
		assigned-clocks = <0x2 0x34>;  /* 0x2->&{/clock-controller@ff490000}, 0x34->&{/qos@fe860200} */
		assigned-clock-rates = <0x3d0900>;
		clocks = <0x2 0x34 0x2 0x10e 0x2 0x35>;  /* 0x2->&{/clock-controller@ff490000}, 0x34->&{/qos@fe860200}, 0x2->&{/clock-controller@ff490000}, 0x10e->&{/mipi-csi2@ffb10000}, 0x2->&{/clock-controller@ff490000}, 0x35->&{/qos@fe86c000} */
		clock-names = "tsadc", "apb_pclk", "phy_clk";
		resets = <0x2 0xd8 0x2 0xd9 0x2 0xda>;  /* 0x2->&{/clock-controller@ff490000}, 0xd8->&{/dummy_cpll}, 0x2->&{/clock-controller@ff490000}, 0xd9->&{/external-gmac-clockm0}, 0x2->&{/clock-controller@ff490000}, 0xda->&{/external-gmac-clockm1} */
		reset-names = "tsadc-apb", "tsadc", "tsadc-phy";
		rockchip,hw-tshut-temp = <0x1d4c0>;
		#thermal-sensor-cells = <0x1>;
		nvmem-cells = <0x6e 0x6f 0x6b>;
		nvmem-cell-names = "trim_l", "trim_h", "trim_base";
		rockchip,hw-tshut-mode = "", "", "", "";
		rockchip,hw-tshut-polarity = "", "", "", "";
		pinctrl-names = "gpio", "otpout";
		pinctrl-0 = <&{/pinctrl/tsadc/tsadcm0-shut}>;
		pinctrl-1 = <&{/pinctrl/tsadc/tsadc-shutorg}>;
		status = "okay";
		phandle = <0x1f>;
	};
	dcf@ff600000 {
		compatible = "syscon";
		reg = <0xff600000 0x1000>;
		status = "disabled";
		phandle = <0x7c>;
	};
	can@ff610000 {
		compatible = "rockchip,can-1.0";
		reg = <0xff610000 0x100>;
		interrupts = <0x0 0x64 0x4>;
		assigned-clocks = <0x2 0x33>;  /* 0x2->&{/clock-controller@ff490000}, 0x33->&{/qos@fe860080} */
		assigned-clock-rates = <0xbebc200>;
		clocks = <0x2 0x33 0x2 0x10d>;  /* 0x2->&{/clock-controller@ff490000}, 0x33->&{/qos@fe860080}, 0x2->&{/clock-controller@ff490000}, 0x10d->&{/vop@ffb00000} */
		clock-names = "baudclk", "apb_pclk";
		resets = <0x2 0x51 0x2 0x50>;  /* 0x2->&{/clock-controller@ff490000}, 0x51->&{/pinctrl/gpio1@ff620000}, 0x2->&{/clock-controller@ff490000}, 0x50->&{/vcc-dvdd} */
		reset-names = "can", "can-apb";
		status = "disabled";
		phandle = <0x102>;
	};
	rktimer@ff660000 {
		compatible = "rockchip,rk3288-timer";
		reg = <0xff660000 0x20>;
		interrupts = <0x0 0x18 0x4>;
		clocks = <0x2 0x10b 0x2 0x2d>;  /* 0x2->&{/clock-controller@ff490000}, 0x10b->&{/dmcdbg}, 0x2->&{/clock-controller@ff490000}, 0x2d->&{/qos@fe8a0000} */
		clock-names = "pclk", "timer";
		phandle = <0x103>;
	};
	watchdog@ff680000 {
		compatible = "rockchip,rv1126-wdt", "snps,dw-wdt";
		reg = <0xff680000 0x100>;
		clocks = <0x2 0xf8>;  /* 0x2->&{/clock-controller@ff490000}, 0xf8->&{/pwm@ff550020} */
		interrupts = <0x0 0x20 0x4>;
		status = "okay";
		phandle = <0x104>;
	};
	mailbox@ff6a0000 {
		compatible = "rockchip,rv1126-mailbox", "rockchip,rk3368-mailbox";
		reg = <0xff6a0000 0x1000>;
		interrupts = <0x0 0x6f 0x4>;
		clocks = <0x2 0xf9>;  /* 0x2->&{/clock-controller@ff490000}, 0xf9->&{/pwm@ff550030} */
		clock-names = "pclk_mailbox";
		#mbox-cells = <0x1>;
		status = "disabled";
		phandle = <0x105>;
	};
	decompress@ff6c0000 {
		compatible = "rockchip,hw-decompress";
		reg = <0xff6c0000 0x1000>;
		interrupts = <0x0 0x51 0x4>;
		clocks = <0x2 0xa4 0x2 0x96 0x2 0x10c>;  /* 0x2->&{/clock-controller@ff490000}, 0xa4->&{/pinctrl/emmc/emmc-bus8}, 0x2->&{/clock-controller@ff490000}, 0x96->&{/rkvenc-opp-table}, 0x2->&{/clock-controller@ff490000}, 0x10c->&{/rk_rga@ffaf0000} */
		clock-names = "aclk", "dclk", "pclk";
		resets = <0x2 0x57>;  /* 0x2->&{/clock-controller@ff490000}, 0x57->&{/pinctrl/pwm9/pwm9m1-pins} */
		reset-names = "dresetn";
		status = "disabled";
		phandle = <0x106>;
	};
	i2s@ff800000 {
		compatible = "rockchip,rv1126-i2s-tdm";
		reg = <0xff800000 0x1000>;
		interrupts = <0x0 0x2e 0x4>;
		clocks = <0x2 0x3d 0x2 0x41 0x2 0xcd>;  /* 0x2->&{/clock-controller@ff490000}, 0x3d->&{/pinctrl/uart1/uart1m0-xfer}, 0x2->&{/clock-controller@ff490000}, 0x41->&{/pinctrl/pwm-pull-down/pwm1m0-pins}, 0x2->&{/clock-controller@ff490000}, 0xcd->&{/rkcif_dvp_sditf} */
		clock-names = "mclk_tx", "mclk_rx", "hclk";
		dmas = <0x3c 0x14 0x3c 0x13>;  /* 0x3c->&{/amba/dma-controller@ff4e0000}, 0x14->&{/rkcif_dvp}, 0x3c->&{/amba/dma-controller@ff4e0000}, 0x13->&{/reserved-memory/isp} */
		dma-names = "tx", "rx";
		resets = <0x2 0x63 0x2 0x64>;  /* 0x2->&{/clock-controller@ff490000}, 0x63->&{/pinctrl/uart5/uart5m0-ctsn}, 0x2->&{/clock-controller@ff490000}, 0x64->&{/pinctrl/uart5/uart5m0-rtsn} */
		reset-names = "tx-m", "rx-m";
		rockchip,cru = <0x2>;
		rockchip,grf = <0x48>;
		status = "okay";
		#sound-dai-cells = "", "", "", "";
		phandle = <0xc2>;
	};
	i2s@ff810000 {
		compatible = "rockchip,rv1126-i2s", "rockchip,rk3066-i2s";
		reg = <0xff810000 0x1000>;
		interrupts = <0x0 0x2f 0x4>;
		clocks = <0x2 0x47 0x2 0xce>;  /* 0x2->&{/clock-controller@ff490000}, 0x47->&{/pinctrl/pwm7/pwm7m0-pins}, 0x2->&{/clock-controller@ff490000}, 0xce->&{/rkcif_lite_sditf} */
		clock-names = "i2s_clk", "i2s_hclk";
		dmas = <0x3c 0x16 0x3c 0x15>;  /* 0x3c->&{/amba/dma-controller@ff4e0000}, 0x16->&{/iommu@ffae8800}, 0x3c->&{/amba/dma-controller@ff4e0000}, 0x15->&{/rkcif_lite@ffae8000} */
		dma-names = "tx", "rx";
		pinctrl-names = "default";
		pinctrl-0 = <0x70 0x71 0x72 0x73>;  /* 0x70->&{/pinctrl/i2s1/i2s1m0-sclk}, 0x71->&{/pinctrl/i2s1/i2s1m0-lrck}, 0x72->&{/pinctrl/i2s1/i2s1m0-sdi}, 0x73->&{/pinctrl/i2s1/i2s1m0-sdo} */
		status = "disabled";
		phandle = <0x107>;
	};
	i2s@ff820000 {
		compatible = "rockchip,rv1126-i2s", "rockchip,rk3066-i2s";
		reg = <0xff820000 0x1000>;
		interrupts = <0x0 0x30 0x4>;
		clocks = <0x2 0x4c 0x2 0xcf>;  /* 0x2->&{/clock-controller@ff490000}, 0x4c->&{/usb2-phy@ff4c8000}, 0x2->&{/clock-controller@ff490000}, 0xcf->&{/rkcif_mipi_lvds_sditf} */
		clock-names = "i2s_clk", "i2s_hclk";
		dmas = <0x3c 0x18 0x3c 0x17>;  /* 0x3c->&{/amba/dma-controller@ff4e0000}, 0x18->&{/mipi-csi2@ffb10000/ports/port@1/endpoint@0}, 0x3c->&{/amba/dma-controller@ff4e0000}, 0x17->&{/rkcif_lite_mipi_lvds} */
		dma-names = "tx", "rx";
		pinctrl-names = "default";
		pinctrl-0 = <0x74 0x75 0x76 0x77>;  /* 0x74->&{/pinctrl/i2s2/i2s2m0-sclk}, 0x75->&{/pinctrl/i2s2/i2s2m0-lrck}, 0x76->&{/pinctrl/i2s2/i2s2m0-sdi}, 0x77->&{/pinctrl/i2s2/i2s2m0-sdo} */
		status = "disabled";
		phandle = <0x108>;
	};
	pdm@ff830000 {
		compatible = "rockchip,rv1126-pdm", "rockchip,pdm";
		reg = <0xff830000 0x1000>;
		clocks = <0x2 0x4e 0x2 0xd0>;  /* 0x2->&{/clock-controller@ff490000}, 0x4e->&{/pinctrl/i2c1/i2c1-xfer}, 0x2->&{/clock-controller@ff490000}, 0xd0->&{/rockchip-suspend} */
		clock-names = "pdm_clk", "pdm_hclk";
		dmas = <0x3c 0x19>;  /* 0x3c->&{/amba/dma-controller@ff4e0000}, 0x19->&{/rkcif_mipi_lvds} */
		dma-names = "rx";
		pinctrl-names = "default";
		pinctrl-0 = <0x78 0x79>;  /* 0x78->&{/pinctrl/pdm/pdmm0-clk}, 0x79->&{/pinctrl/pdm/pdmm0-sdi0} */
		status = "okay";
		#sound-dai-cells = "", "", "", "";
		phandle = <0xc4>;
	};
	audpwm@ff840000 {
		compatible = "rockchip,rv1126-audio-pwm", "rockchip,audio-pwm-v1";
		reg = <0xff840000 0x1000>;
		clocks = <0x2 0x52 0x2 0xd1>;  /* 0x2->&{/clock-controller@ff490000}, 0x52->&{/csi-dphy@ff4b0000/ports/port@0/endpoint@1}, 0x2->&{/clock-controller@ff490000}, 0xd1->&{/rockchip-system-monitor} */
		clock-names = "clk", "hclk";
		dmas = <0x3c 0x1a>;  /* 0x3c->&{/amba/dma-controller@ff4e0000}, 0x1a->&{/rkisp-vir0/ports/port@0/endpoint@0} */
		dma-names = "tx";
		pinctrl-names = "default";
		pinctrl-0 = <&{/pinctrl/audpwm/audpwmm0-pins}>;
		rockchip,sample-width-bits = <0xb>;
		rockchip,interpolat-points = <0x1>;
		status = "disabled";
		phandle = <0x109>;
	};
	codec-digital@ff850000 {
		compatible = "rockchip,rv1126-codec-digital", "rockchip,codec-digital-v1";
		reg = <0xff850000 0x1000>;
		clocks = <0x2 0x53 0x2 0x54 0x2 0x110>;  /* 0x2->&{/clock-controller@ff490000}, 0x53->&{/pinctrl/i2c3/i2c3m0-xfer}, 0x2->&{/clock-controller@ff490000}, 0x54->&{/pinctrl/i2c4/i2c4m0-xfer}, 0x2->&{/clock-controller@ff490000}, 0x110->&{/dsi@ffb30000} */
		clock-names = "adc", "dac", "pclk";
		pinctrl-names = "default";
		pinctrl-0 = <&{/pinctrl/auddsm/auddsm-pins}>;
		resets = <0x2 0x6e>;  /* 0x2->&{/clock-controller@ff490000}, 0x6e->&{/otp@ff5c0000/npu-tsadc-trim-l@25} */
		reset-names = "reset";
		rockchip,grf = <0x48>;
		status = "okay";
		#sound-dai-cells = "", "", "", "";
		rockchip,pwm-output-mode;
		rockchip,pa-ctl-mdelay = <0xc8>;
		pa-ctl-gpios = <0x4b 0x13 0x1>;
		phandle = <0xc3>;
	};
	dfi@ff9c0000 {
		reg = <0xff9c0000 0x400>;
		compatible = "rockchip,rv1126-dfi";
		rockchip,pmugrf = <0x3a>;
		status = "disabled";
		phandle = <0x7d>;
	};
	dmc {
		compatible = "rockchip,rv1126-dmc";
		dcf = <0x7c>;
		interrupts = <0x0 0x0 0x4>;
		interrupt-names = "complete";
		devfreq-events = <0x7d>;
		clocks = <0x2 0x93>;  /* 0x2->&{/clock-controller@ff490000}, 0x93->&{/rkisp-vir2/ports/port@1/endpoint@1} */
		clock-names = "dmc_clk";
		operating-points-v2 = <0x7e>;
		ddr_timing = <0x7f>;
		upthreshold = <0x28>;
		downdifferential = <0x14>;
		system-status-freq = <0x1 0xe1960 0x8 0x50140 0x2 0x50140 0x20 0xe1960 0x1000 0xe1960 0x4000 0xe1960 0x2000 0xe1960>;
		auto-min-freq = <0x50140>;
		auto-freq-en = <0x1>;
		#cooling-cells = <0x2>;
		status = "disabled";
		phandle = <0x10a>;
	};
	dmc-opp-table {
		compatible = "operating-points-v2";
		phandle = <0x7e>;
		opp-328000000 {
			opp-hz = <0x0 0x138ce200>;
			opp-microvolt = <0xc3500>;
		};
		opp-528000000 {
			opp-hz = <0x0 0x1f78a400>;
			opp-microvolt = <0xc3500>;
		};
		opp-784000000 {
			opp-hz = <0x0 0x2ebae400>;
			opp-microvolt = <0xc3500>;
		};
		opp-924000000 {
			opp-hz = <0x0 0x37131f00>;
			opp-microvolt = <0xc3500>;
		};
		opp-1056000000 {
			opp-hz = <0x0 0x3ef14800>;
			opp-microvolt = <0xc3500>;
			status = "disabled";
		};
	};
	dmcdbg {
		compatible = "rockchip,rv1126-dmcdbg";
		status = "disabled";
		phandle = <0x10b>;
	};
	rkcif@ffae0000 {
		compatible = "rockchip,rv1126-cif";
		reg = <0xffae0000 0x8000>;
		reg-names = "cif_regs";
		interrupts = <0x0 0x3a 0x4>;
		interrupt-names = "cif-intr";
		clocks = <0x2 0xb5 0x2 0xde 0x2 0x9b>;  /* 0x2->&{/clock-controller@ff490000}, 0xb5->&{/pinctrl/pcfg-pull-up}, 0x2->&{/clock-controller@ff490000}, 0xde->&{/i2c@ff3f0000}, 0x2->&{/clock-controller@ff490000}, 0x9b->&{/ethernet@ffc40000/rx-queues-config} */
		clock-names = "aclk_cif", "hclk_cif", "dclk_cif";
		resets = <0x2 0x94 0x2 0x95 0x2 0x96 0x2 0x97 0x2 0x98 0x2 0x99>;  /* 0x2->&{/clock-controller@ff490000}, 0x94->&{/iommu@ffb80480}, 0x2->&{/clock-controller@ff490000}, 0x95->&{/iommu@ffb90800}, 0x2->&{/clock-controller@ff490000}, 0x96->&{/rkvenc-opp-table}, 0x2->&{/clock-controller@ff490000}, 0x97->&{/iommu@ffbb0f00}, 0x2->&{/clock-controller@ff490000}, 0x98->&{/otp@ff5c0000/venc-leakage@1a}, 0x2->&{/clock-controller@ff490000}, 0x99->&{/otp@ff5c0000/venc-performance@1f} */
		reset-names = "rst_cif_a", "rst_cif_h", "rst_cif_d", "rst_cif_p", "rst_cif_i", "rst_cif_rx_p";
		assigned-clocks = <0x2 0x9b>;  /* 0x2->&{/clock-controller@ff490000}, 0x9b->&{/ethernet@ffc40000/rx-queues-config} */
		assigned-clock-rates = <0x11e1a300>;
		power-domains = <0x4d 0x9>;  /* 0x4d->&{/power-management@ff3e0000/power-controller}, 0x9->&{/otp@ff5c0000/cpu-code@2} */
		rockchip,grf = <0x48>;
		status = "okay";
		iommus = <&{/iommu@ffae0800}>;
		phandle = <0x12>;
	};
	iommu@ffae0800 {
		compatible = "rockchip,iommu";
		reg = <0xffae0800 0x100>;
		interrupts = <0x0 0x3a 0x4>;
		interrupt-names = "cif_mmu";
		clocks = <0x2 0xb5 0x2 0xde>;  /* 0x2->&{/clock-controller@ff490000}, 0xb5->&{/pinctrl/pcfg-pull-up}, 0x2->&{/clock-controller@ff490000}, 0xde->&{/i2c@ff3f0000} */
		clock-names = "aclk", "iface";
		power-domains = <0x4d 0x9>;  /* 0x4d->&{/power-management@ff3e0000/power-controller}, 0x9->&{/otp@ff5c0000/cpu-code@2} */
		#iommu-cells = "", "", "", "";
		status = "okay";
		phandle = <0x80>;
	};
	rkcif_lite@ffae8000 {
		compatible = "rockchip,rv1126-cif-lite";
		reg = <0xffae8000 0x8000>;
		reg-names = "cif_regs";
		interrupts = <0x0 0x35 0x4>;
		interrupt-names = "cif-lite-intr";
		clocks = <0x2 0xb6 0x2 0xdf 0x2 0x9c>;  /* 0x2->&{/clock-controller@ff490000}, 0xb6->&{/pinctrl/pcfg-pull-down}, 0x2->&{/clock-controller@ff490000}, 0xdf->&{/i2c@ff400000}, 0x2->&{/clock-controller@ff490000}, 0x9c->&{/ethernet@ffc40000/tx-queues-config} */
		clock-names = "aclk_cif_lite", "hclk_cif_lite", "dclk_cif_lite";
		resets = <0x2 0xdc 0x2 0xdd 0x2 0xde 0x2 0xdf>;  /* 0x2->&{/clock-controller@ff490000}, 0xdc->&{/syscon@fe020000/io-domains}, 0x2->&{/clock-controller@ff490000}, 0xdd->&{/power-management@ff3e0000}, 0x2->&{/clock-controller@ff490000}, 0xde->&{/i2c@ff3f0000}, 0x2->&{/clock-controller@ff490000}, 0xdf->&{/i2c@ff400000} */
		reset-names = "rst_cif_lite_a", "rst_cif_lite_h", "rst_cif_lite_d", "rst_cif_lite_rx_p";
		assigned-clocks = <0x2 0x9c>;  /* 0x2->&{/clock-controller@ff490000}, 0x9c->&{/ethernet@ffc40000/tx-queues-config} */
		assigned-clock-rates = <0x11e1a300>;
		power-domains = <0x4d 0x9>;  /* 0x4d->&{/power-management@ff3e0000/power-controller}, 0x9->&{/otp@ff5c0000/cpu-code@2} */
		iommus = <&{/iommu@ffae8800}>;
		status = "disabled";
		phandle = <0x15>;
	};
	iommu@ffae8800 {
		compatible = "rockchip,iommu";
		reg = <0xffae8800 0x100>;
		interrupts = <0x0 0x35 0x4>;
		interrupt-names = "cif_lite_mmu";
		clocks = <0x2 0xb6 0x2 0xdf>;  /* 0x2->&{/clock-controller@ff490000}, 0xb6->&{/pinctrl/pcfg-pull-down}, 0x2->&{/clock-controller@ff490000}, 0xdf->&{/i2c@ff400000} */
		clock-names = "aclk", "iface";
		power-domains = <0x4d 0x9>;  /* 0x4d->&{/power-management@ff3e0000/power-controller}, 0x9->&{/otp@ff5c0000/cpu-code@2} */
		#iommu-cells = "", "", "", "";
		status = "disabled";
		phandle = <0x16>;
	};
	rk_rga@ffaf0000 {
		compatible = "rockchip,rga2";
		reg = <0xffaf0000 0x1000>;
		interrupts = <0x0 0x3e 0x4>;
		clocks = <0x2 0xae 0x2 0xd9 0x2 0x5a>;  /* 0x2->&{/clock-controller@ff490000}, 0xae->&{/otp@ff5c0000/npu-performance@1f}, 0x2->&{/clock-controller@ff490000}, 0xd9->&{/external-gmac-clockm0}, 0x2->&{/clock-controller@ff490000}, 0x5a->&{/pinctrl/uart0/uart0-xfer} */
		clock-names = "aclk_rga", "hclk_rga", "clk_rga";
		power-domains = <0x4d 0xa>;  /* 0x4d->&{/power-management@ff3e0000/power-controller}, 0xa->&{/cpus/cpu@f00} */
		status = "okay";
		phandle = <0x10c>;
	};
	vop@ffb00000 {
		compatible = "rockchip,rv1126-vop";
		reg = <0xffb00000 0x200 0xffb00a00 0x400>;
		reg-names = "regs", "gamma_lut";
		rockchip,grf = <0x48>;
		interrupts = <0x0 0x3b 0x4>;
		clocks = <0x2 0xaf 0x2 0x9a 0x2 0xda>;  /* 0x2->&{/clock-controller@ff490000}, 0xaf->&{/usb2-phy@ff4c0000/otg-port}, 0x2->&{/clock-controller@ff490000}, 0x9a->&{/ethernet@ffc40000/stmmac-axi-config}, 0x2->&{/clock-controller@ff490000}, 0xda->&{/external-gmac-clockm1} */
		clock-names = "aclk_vop", "dclk_vop", "hclk_vop";
		iommus = <&{/iommu@ffb00f00}>;
		power-domains = <0x4d 0xa>;  /* 0x4d->&{/power-management@ff3e0000/power-controller}, 0xa->&{/cpus/cpu@f00} */
		status = "okay";
		phandle = <0x10d>;
		port {
			#address-cells = <0x1>;
			#size-cells = "", "", "", "";
			phandle = <0xe>;
			endpoint@0 {
				reg = "", "", "", "";
				remote-endpoint = <&{/syscon@fe000000/rgb/ports/port@0/endpoint@0}>;
				phandle = <0x11>;
			};
			endpoint@1 {
				reg = <0x1>;
				remote-endpoint = <&{/dsi@ffb30000/ports/port/endpoint}>;
				phandle = <0x10>;
			};
		};
	};
	iommu@ffb00f00 {
		compatible = "rockchip,iommu";
		reg = <0xffb00f00 0x100>;
		interrupts = <0x0 0x3b 0x4>;
		interrupt-names = "vop_mmu";
		clocks = <0x2 0xaf 0x2 0xda>;  /* 0x2->&{/clock-controller@ff490000}, 0xaf->&{/usb2-phy@ff4c0000/otg-port}, 0x2->&{/clock-controller@ff490000}, 0xda->&{/external-gmac-clockm1} */
		clock-names = "aclk", "iface";
		#iommu-cells = "", "", "", "";
		rockchip,disable-device-link-resume;
		power-domains = <0x4d 0xa>;  /* 0x4d->&{/power-management@ff3e0000/power-controller}, 0xa->&{/cpus/cpu@f00} */
		status = "disabled";
		phandle = <0x81>;
	};
	mipi-csi2@ffb10000 {
		compatible = "rockchip,rv1126-mipi-csi2";
		reg = <0xffb10000 0x10000>;
		reg-names = "csihost_regs";
		interrupts = <0x0 0x38 0x4 0x0 0x39 0x4>;
		interrupt-names = "csi-intr1", "csi-intr2";
		clocks = <0x2 0x114>;  /* 0x2->&{/clock-controller@ff490000}, 0x114->&{/rkispp-vir0} */
		clock-names = "pclk_csi2host";
		resets = <0x2 0x9f>;  /* 0x2->&{/clock-controller@ff490000}, 0x9f->&{/pinctrl/rmii/rmiim0-bus2} */
		reset-names = "srst_csihost_p";
		power-domains = <0x4d 0x9>;  /* 0x4d->&{/power-management@ff3e0000/power-controller}, 0x9->&{/otp@ff5c0000/cpu-code@2} */
		status = "okay";
		phandle = <0x10e>;
		ports {
			port@0 {
				endpoint@1 {
					remote-endpoint = <&{/csi-dphy@ff4b0000/ports/port@1/endpoint@0}>;
					data-lanes = <0x1 0x2>;
					phandle = <0x4a>;
				};
			};
			port@1 {
				endpoint@0 {
					remote-endpoint = <&{/rkcif_mipi_lvds/port/endpoint}>;
					data-lanes = <0x1 0x2>;
					phandle = <0x18>;
				};
			};
		};
	};
	iep@ffb20000 {
		compatible = "rockchip,rv1126-iep", "rockchip,iep-v2";
		reg = <0xffb20000 0x500>;
		interrupts = <0x0 0x72 0x4>;
		clocks = <0x2 0xb0 0x2 0xdb 0x2 0x5b>;  /* 0x2->&{/clock-controller@ff490000}, 0xb0->&{/usb2-phy@ff4c0000}, 0x2->&{/clock-controller@ff490000}, 0xdb->&{/syscon@fe000000/rgb}, 0x2->&{/clock-controller@ff490000}, 0x5b->&{/pinctrl/uart0/uart0-ctsn} */
		clock-names = "aclk", "hclk", "sclk";
		resets = <0x2 0x8b 0x2 0x8c 0x2 0x8d>;  /* 0x2->&{/clock-controller@ff490000}, 0x8b->&{/rkispp-vir0/port/endpoint@0}, 0x2->&{/clock-controller@ff490000}, 0x8c->&{/rkcif_mipi_lvds_sditf/port/endpoint}, 0x2->&{/clock-controller@ff490000}, 0x8d->&{/rkispp-vir1/port/endpoint@0} */
		reset-names = "rst_a", "rst_h", "rst_s";
		power-domains = <0x4d 0xa>;  /* 0x4d->&{/power-management@ff3e0000/power-controller}, 0xa->&{/cpus/cpu@f00} */
		rockchip,srv = <0x86>;
		rockchip,taskqueue-node = <0x3>;
		rockchip,resetgroup-node = <0x3>;
		iommus = <&{/iommu@ffb20800}>;
		status = "disabled";
		phandle = <0x10f>;
	};
	iommu@ffb20800 {
		compatible = "rockchip,iommu";
		reg = <0xffb20800 0x100>;
		interrupts = <0x0 0x72 0x4>;
		interrupt-names = "iep_mmu";
		clocks = <0x2 0xb0 0x2 0xdb>;  /* 0x2->&{/clock-controller@ff490000}, 0xb0->&{/usb2-phy@ff4c0000}, 0x2->&{/clock-controller@ff490000}, 0xdb->&{/syscon@fe000000/rgb} */
		clock-names = "aclk", "iface";
		#iommu-cells = "", "", "", "";
		power-domains = <0x4d 0xa>;  /* 0x4d->&{/power-management@ff3e0000/power-controller}, 0xa->&{/cpus/cpu@f00} */
		status = "disabled";
		phandle = <0x87>;
	};
	dsi@ffb30000 {
		compatible = "rockchip,rv1126-mipi-dsi";
		reg = <0xffb30000 0x500>;
		interrupts = <0x0 0x3d 0x4>;
		clocks = <0x2 0x112 0x88>;  /* 0x2->&{/clock-controller@ff490000}, 0x112->&{/rkisp-vir1}, 0x88->&{/mipi-dphy@ff4d0000} */
		clock-names = "pclk", "hs_clk";
		resets = <0x2 0x8a>;  /* 0x2->&{/clock-controller@ff490000}, 0x8a->&{/rkisp@ffb50000} */
		reset-names = "apb";
		phys = <&{/mipi-dphy@ff4d0000}>;
		phy-names = "mipi_dphy";
		rockchip,grf = <0x48>;
		#address-cells = <0x1>;
		#size-cells = "", "", "", "";
		power-domains = <0x4d 0xa>;  /* 0x4d->&{/power-management@ff3e0000/power-controller}, 0xa->&{/cpus/cpu@f00} */
		status = "disabled";
		phandle = <0x110>;
		ports {
			port {
				endpoint {
					remote-endpoint = <&{/vop@ffb00000/port/endpoint@1}>;
					phandle = <0x83>;
				};
			};
		};
	};
	rkisp@ffb50000 {
		compatible = "rockchip,rv1126-rkisp";
		reg = <0xffb50000 0x10000>;
		interrupts = <0x0 0x34 0x4 0x0 0x36 0x4 0x0 0x37 0x4>;
		interrupt-names = "isp_irq", "mi_irq", "mipi_irq";
		clocks = <0x2 0xb4 0x2 0xdd 0x2 0x5f>;  /* 0x2->&{/clock-controller@ff490000}, 0xb4->&{/pinctrl/pcfg-pull-up-drv-level-2}, 0x2->&{/clock-controller@ff490000}, 0xdd->&{/power-management@ff3e0000}, 0x2->&{/clock-controller@ff490000}, 0x5f->&{/pinctrl/uart4/uart4m0-xfer} */
		clock-names = "aclk_isp", "hclk_isp", "clk_isp";
		assigned-clocks = <0x2 0xb4 0x2 0xdd>;  /* 0x2->&{/clock-controller@ff490000}, 0xb4->&{/pinctrl/pcfg-pull-up-drv-level-2}, 0x2->&{/clock-controller@ff490000}, 0xdd->&{/power-management@ff3e0000} */
		assigned-clock-rates = <0x1dcd6500 0xee6b280>;
		resets = <0x2 0x93 0x2 0x8e>;  /* 0x2->&{/clock-controller@ff490000}, 0x93->&{/rkisp-vir2/ports/port@1/endpoint@1}, 0x2->&{/clock-controller@ff490000}, 0x8e->&{/rkispp-vir2/port/endpoint@0} */
		reset-names = "isp", "isp-rx-p";
		power-domains = <0x4d 0x9>;  /* 0x4d->&{/power-management@ff3e0000/power-controller}, 0x9->&{/otp@ff5c0000/cpu-code@2} */
		iommus = <&{/iommu@ffb51a00}>;
		status = "okay";
		phandle = <0x8a>;
	};
	iommu@ffb51a00 {
		compatible = "rockchip,iommu";
		reg = <0xffb51a00 0x100>;
		interrupts = <0x0 0x33 0x4>;
		interrupt-names = "isp_mmu";
		clocks = <0x2 0xb4 0x2 0xdd>;  /* 0x2->&{/clock-controller@ff490000}, 0xb4->&{/pinctrl/pcfg-pull-up-drv-level-2}, 0x2->&{/clock-controller@ff490000}, 0xdd->&{/power-management@ff3e0000} */
		clock-names = "aclk", "iface";
		power-domains = <0x4d 0x9>;  /* 0x4d->&{/power-management@ff3e0000/power-controller}, 0x9->&{/otp@ff5c0000/cpu-code@2} */
		#iommu-cells = "", "", "", "";
		rockchip,disable-mmu-reset;
		status = "okay";
		phandle = <0x89>;
	};
	rkisp-vir0 {
		compatible = "rockchip,rv1126-rkisp-vir";
		rockchip,hw = <0x8a>;
		status = "okay";
		phandle = <0x111>;
		ports {
			#address-cells = <0x1>;
			#size-cells = "", "", "", "";
			port@1 {
				reg = <0x1>;
				#address-cells = <0x1>;
				#size-cells = "", "", "", "";
				endpoint@1 {
					reg = <0x1>;
					remote-endpoint = <&{/rkispp-vir0/port/endpoint@0}>;
					phandle = <0x91>;
				};
			};
			port@0 {
				reg = "", "", "", "";
				#address-cells = <0x1>;
				#size-cells = "", "", "", "";
				endpoint@0 {
					reg = "", "", "", "";
					remote-endpoint = <&{/rkcif_mipi_lvds_sditf/port/endpoint}>;
					phandle = <0x1a>;
				};
			};
		};
	};
	rkisp-vir1 {
		compatible = "rockchip,rv1126-rkisp-vir";
		rockchip,hw = <0x8a>;
		status = "disabled";
		phandle = <0x112>;
		ports {
			#address-cells = <0x1>;
			#size-cells = "", "", "", "";
			port@1 {
				reg = <0x1>;
				#address-cells = <0x1>;
				#size-cells = "", "", "", "";
				endpoint@1 {
					reg = <0x1>;
					remote-endpoint = <&{/rkispp-vir1/port/endpoint@0}>;
					phandle = <0x92>;
				};
			};
		};
	};
	rkisp-vir2 {
		compatible = "rockchip,rv1126-rkisp-vir";
		rockchip,hw = <0x8a>;
		status = "disabled";
		phandle = <0x113>;
		ports {
			#address-cells = <0x1>;
			#size-cells = "", "", "", "";
			port@1 {
				reg = <0x1>;
				#address-cells = <0x1>;
				#size-cells = "", "", "", "";
				endpoint@1 {
					reg = <0x1>;
					remote-endpoint = <&{/rkispp-vir2/port/endpoint@0}>;
					phandle = <0x93>;
				};
			};
		};
	};
	rkispp@ffb60000 {
		compatible = "rockchip,rv1126-rkispp";
		reg = <0xffb60000 0x20000>;
		interrupts = <0x0 0x3f 0x4 0x0 0x40 0x4>;
		interrupt-names = "ispp_irq", "fec_irq";
		clocks = <0x2 0xba 0x2 0xe1 0x2 0x6b>;  /* 0x2->&{/clock-controller@ff490000}, 0xba->&{/pinctrl/pcfg-output-low}, 0x2->&{/clock-controller@ff490000}, 0xe1->&{/pwm@ff430000}, 0x2->&{/clock-controller@ff490000}, 0x6b->&{/otp@ff5c0000/tsadc-trim-base@27} */
		clock-names = "aclk_ispp", "hclk_ispp", "clk_ispp";
		assigned-clocks = <0x2 0xba 0x2 0xe1 0x2 0x6b>;  /* 0x2->&{/clock-controller@ff490000}, 0xba->&{/pinctrl/pcfg-output-low}, 0x2->&{/clock-controller@ff490000}, 0xe1->&{/pwm@ff430000}, 0x2->&{/clock-controller@ff490000}, 0x6b->&{/otp@ff5c0000/tsadc-trim-base@27} */
		assigned-clock-rates = <0x1dcd6500 0xee6b280 0x17d78400>;
		power-domains = <0x4d 0xb>;  /* 0x4d->&{/power-management@ff3e0000/power-controller}, 0xb->&{/cpus/cpu@f01} */
		iommus = <&{/iommu@ffb60e00}>;
		rockchip,restart-monitor-en;
		status = "okay";
		phandle = <0x90>;
	};
	iommu@ffb60e00 {
		compatible = "rockchip,iommu";
		reg = <0xffb60e00 0x40 0xffb60e40 0x40 0xffb60f00 0x40>;
		interrupts = <0x0 0x41 0x4 0x0 0x42 0x4 0x0 0x43 0x4>;
		interrupt-names = "ispp_mmu0_r", "ispp_mmu0_w", "ispp_mmu1";
		clocks = <0x2 0xba 0x2 0xe1>;  /* 0x2->&{/clock-controller@ff490000}, 0xba->&{/pinctrl/pcfg-output-low}, 0x2->&{/clock-controller@ff490000}, 0xe1->&{/pwm@ff430000} */
		clock-names = "aclk", "iface";
		power-domains = <0x4d 0xb>;  /* 0x4d->&{/power-management@ff3e0000/power-controller}, 0xb->&{/cpus/cpu@f01} */
		#iommu-cells = "", "", "", "";
		rockchip,disable-mmu-reset;
		status = "okay";
		phandle = <0x8f>;
	};
	rkispp-vir0 {
		compatible = "rockchip,rv1126-rkispp-vir";
		rockchip,hw = <0x90>;
		status = "okay";
		phandle = <0x114>;
		port {
			#address-cells = <0x1>;
			#size-cells = "", "", "", "";
			endpoint@0 {
				reg = "", "", "", "";
				remote-endpoint = <&{/rkisp-vir0/ports/port@1/endpoint@1}>;
				phandle = <0x8b>;
			};
		};
	};
	rkispp-vir1 {
		compatible = "rockchip,rv1126-rkispp-vir";
		rockchip,hw = <0x90>;
		status = "disabled";
		phandle = <0x115>;
		port {
			#address-cells = <0x1>;
			#size-cells = "", "", "", "";
			endpoint@0 {
				reg = "", "", "", "";
				remote-endpoint = <&{/rkisp-vir1/ports/port@1/endpoint@1}>;
				phandle = <0x8d>;
			};
		};
	};
	rkispp-vir2 {
		compatible = "rockchip,rv1126-rkispp-vir";
		rockchip,hw = <0x90>;
		status = "disabled";
		phandle = <0x116>;
		port {
			#address-cells = <0x1>;
			#size-cells = "", "", "", "";
			endpoint@0 {
				reg = "", "", "", "";
				remote-endpoint = <&{/rkisp-vir2/ports/port@1/endpoint@1}>;
				phandle = <0x8e>;
			};
		};
	};
	rkvdec@ffb80000 {
		compatible = "rockchip,rkv-decoder-rv1126", "rockchip,rkv-decoder-v1";
		reg = <0xffb80000 0x400>;
		interrupts = <0x0 0x47 0x4>;
		interrupt-names = "irq_dec";
		clocks = <0x2 0xab 0x2 0xd6 0x2 0x58 0x2 0x57 0x2 0x59>;  /* 0x2->&{/clock-controller@ff490000}, 0xab->&{/pinctrl/sdio/sdio-bus4}, 0x2->&{/clock-controller@ff490000}, 0xd6->&{/thermal-zones/npu-thermal}, 0x2->&{/clock-controller@ff490000}, 0x58->&{/pinctrl/pwm10/pwm10m0-pins}, 0x2->&{/clock-controller@ff490000}, 0x57->&{/pinctrl/pwm9/pwm9m1-pins}, 0x2->&{/clock-controller@ff490000}, 0x59->&{/pinctrl/pwm11/pwm11m0-pins} */
		clock-names = "aclk_vcodec", "hclk_vcodec", "clk_cabac", "clk_core", "clk_hevc_cabac";
		resets = <0x2 0x77 0x2 0x78 0x2 0x7a 0x2 0x79 0x2 0x7b>;  /* 0x2->&{/clock-controller@ff490000}, 0x77->&{/pinctrl/i2s2/i2s2m0-sdo}, 0x2->&{/clock-controller@ff490000}, 0x78->&{/pinctrl/pdm/pdmm0-clk}, 0x2->&{/clock-controller@ff490000}, 0x7a->&{/pinctrl/audpwm/audpwmm0-pins}, 0x2->&{/clock-controller@ff490000}, 0x79->&{/pinctrl/pdm/pdmm0-sdi0}, 0x2->&{/clock-controller@ff490000}, 0x7b->&{/pinctrl/auddsm/auddsm-pins} */
		reset-names = "video_a", "video_h", "video_cabac", "video_core", "video_hevc_cabac";
		power-domains = <0x4d 0xc>;  /* 0x4d->&{/power-management@ff3e0000/power-controller}, 0xc->&{/cpus/cpu@f02} */
		iommus = <&{/iommu@ffb80480}>;
		rockchip,srv = <0x86>;
		rockchip,taskqueue-node = "", "", "", "";
		rockchip,resetgroup-node = "", "", "", "";
		status = "okay";
		phandle = <0x117>;
	};
	iommu@ffb80480 {
		compatible = "rockchip,iommu";
		reg = <0xffb80480 0x40 0xffb804c0 0x40>;
		interrupts = <0x0 0x48 0x4>;
		interrupt-names = "rkvdec_mmu";
		clocks = <0x2 0xab 0x2 0xd6>;  /* 0x2->&{/clock-controller@ff490000}, 0xab->&{/pinctrl/sdio/sdio-bus4}, 0x2->&{/clock-controller@ff490000}, 0xd6->&{/thermal-zones/npu-thermal} */
		clock-names = "aclk", "iface";
		power-domains = <0x4d 0xc>;  /* 0x4d->&{/power-management@ff3e0000/power-controller}, 0xc->&{/cpus/cpu@f02} */
		#iommu-cells = "", "", "", "";
		status = "okay";
		phandle = <0x94>;
	};
	vepu@ffb90000 {
		compatible = "rockchip,vpu-encoder-v2";
		reg = <0xffb90000 0x400>;
		interrupts = <0x0 0x4a 0x4>;
		clocks = <0x2 0xac 0x2 0xd7>;  /* 0x2->&{/clock-controller@ff490000}, 0xac->&{/npu-opp-table}, 0x2->&{/clock-controller@ff490000}, 0xd7->&{/oscillator} */
		clock-names = "aclk_vcodec", "hclk_vcodec";
		rockchip,normal-rates = <0x17d78400 0x0>;
		rockchip,advanced-rates = <0x1dcd6500 0x0>;
		rockchip,default-max-load = <0x1fe000>;
		resets = <0x2 0x7e 0x2 0x7f>;  /* 0x2->&{/clock-controller@ff490000}, 0x7e->&{/dmc-opp-table}, 0x2->&{/clock-controller@ff490000}, 0x7f->&{/ddr_timing} */
		reset-names = "shared_video_a", "shared_video_h";
		iommus = <&{/iommu@ffb90800}>;
		rockchip,srv = <0x86>;
		rockchip,taskqueue-node = <0x1>;
		rockchip,resetgroup-node = <0x1>;
		power-domains = <0x4d 0xc>;  /* 0x4d->&{/power-management@ff3e0000/power-controller}, 0xc->&{/cpus/cpu@f02} */
		status = "okay";
		phandle = <0x118>;
	};
	vdpu@ffb90400 {
		compatible = "rockchip,vpu-decoder-v2";
		reg = <0xffb90400 0x400>;
		interrupts = <0x0 0x49 0x4>;
		interrupt-names = "irq_dec";
		clocks = <0x2 0xac 0x2 0xd7>;  /* 0x2->&{/clock-controller@ff490000}, 0xac->&{/npu-opp-table}, 0x2->&{/clock-controller@ff490000}, 0xd7->&{/oscillator} */
		clock-names = "aclk_vcodec", "hclk_vcodec";
		resets = <0x2 0x7e 0x2 0x7f>;  /* 0x2->&{/clock-controller@ff490000}, 0x7e->&{/dmc-opp-table}, 0x2->&{/clock-controller@ff490000}, 0x7f->&{/ddr_timing} */
		reset-names = "shared_video_a", "shared_video_h";
		iommus = <&{/iommu@ffb90800}>;
		power-domains = <0x4d 0xc>;  /* 0x4d->&{/power-management@ff3e0000/power-controller}, 0xc->&{/cpus/cpu@f02} */
		rockchip,srv = <0x86>;
		rockchip,taskqueue-node = <0x1>;
		rockchip,resetgroup-node = <0x1>;
		status = "okay";
		phandle = <0x119>;
	};
	iommu@ffb90800 {
		compatible = "rockchip,iommu";
		reg = <0xffb90800 0x40>;
		interrupts = <0x0 0x4b 0x4>;
		interrupt-names = "vpu_mmu";
		clock-names = "aclk", "iface";
		clocks = <0x2 0xac 0x2 0xd7>;  /* 0x2->&{/clock-controller@ff490000}, 0xac->&{/npu-opp-table}, 0x2->&{/clock-controller@ff490000}, 0xd7->&{/oscillator} */
		power-domains = <0x4d 0xc>;  /* 0x4d->&{/power-management@ff3e0000/power-controller}, 0xc->&{/cpus/cpu@f02} */
		#iommu-cells = "", "", "", "";
		status = "okay";
		phandle = <0x95>;
	};
	rkvenc@ffbb0000 {
		compatible = "rockchip,rkv-encoder-rv1126", "rockchip,rkv-encoder-v1";
		reg = <0xffbb0000 0x400>;
		interrupts = <0x0 0x44 0x4>;
		interrupt-names = "irq_enc";
		clocks = <0x2 0xa8 0x2 0xd3 0x2 0x56>;  /* 0x2->&{/clock-controller@ff490000}, 0xa8->&{/pinctrl/sdmmc0/sdmmc0-bus4}, 0x2->&{/clock-controller@ff490000}, 0xd3->&{/thermal-zones/cpu-thermal}, 0x2->&{/clock-controller@ff490000}, 0x56->&{/pinctrl/pwm8/pwm8m1-pins} */
		clock-names = "aclk_vcodec", "hclk_vcodec", "clk_core";
		rockchip,normal-rates = <0x11b3dc40 0x0 0x179a7b00>;
		rockchip,advanced-rates = <0x11b3dc40 0x0 0x2367b880>;
		rockchip,default-max-load = <0x1fe000>;
		resets = <0x2 0x72 0x2 0x73 0x2 0x74>;  /* 0x2->&{/clock-controller@ff490000}, 0x72->&{/pinctrl/i2s1/i2s1m0-sdi}, 0x2->&{/clock-controller@ff490000}, 0x73->&{/pinctrl/i2s1/i2s1m0-sdo}, 0x2->&{/clock-controller@ff490000}, 0x74->&{/pinctrl/i2s2/i2s2m0-sclk} */
		reset-names = "video_a", "video_h", "video_core";
		assigned-clocks = <0x2 0xa8 0x2 0x56>;  /* 0x2->&{/clock-controller@ff490000}, 0xa8->&{/pinctrl/sdmmc0/sdmmc0-bus4}, 0x2->&{/clock-controller@ff490000}, 0x56->&{/pinctrl/pwm8/pwm8m1-pins} */
		assigned-clock-rates = <0x11b3dc40 0x179a7b00>;
		operating-points-v2 = <0x96>;
		dynamic-power-coefficient = <0x58a>;
		#cooling-cells = <0x2>;
		iommus = <&{/iommu@ffbb0f00}>;
		node-name = "rkvenc";
		rockchip,srv = <0x86>;
		rockchip,taskqueue-node = <0x2>;
		rockchip,resetgroup-node = <0x2>;
		power-domains = <0x4d 0x8>;  /* 0x4d->&{/power-management@ff3e0000/power-controller}, 0x8->&{/otp@ff5c0000/id@7} */
		status = "okay";
		venc-supply = <&{/vdd-arm-logic-npu-vepu-fixed}>;
		phandle = <0x1e>;
	};
	rkvenc-opp-table {
		compatible = "operating-points-v2";
		nvmem-cells = <0x98 0x99>;
		nvmem-cell-names = "leakage", "performance";
		rockchip,temp-freq-table = <0x13880 0x7a120 0x186a0 0x60ae0>;
		clocks = <0x38 0x1>;  /* 0x38->&{/clock-controller@ff480000}, 0x1->&{/interrupt-controller@feff0000} */
		rockchip,bin-scaling-sel = <0x0 0x25 0x1 0x2b>;
		rockchip,bin-voltage-sel = <0x1 0x0>;
		rockchip,evb-irdrop = <0x61a8>;
		phandle = <0x96>;
		opp-297000000 {
			opp-hz = <0x0 0x11b3dc40>;
			opp-microvolt = <0xb1008 0xb1008 0xf4240>;
			opp-microvolt-L0 = <0xb71b0 0xb71b0 0xf4240>;
		};
		opp-396000000 {
			opp-hz = <0x0 0x179a7b00>;
			opp-microvolt = <0xb1008 0xb1008 0xf4240>;
			opp-microvolt-L0 = <0xbd358 0xbd358 0xf4240>;
		};
		opp-500000000 {
			opp-hz = <0x0 0x1dcd6500>;
			opp-microvolt = <0xb71b0 0xb71b0 0xf4240>;
		};
		opp-594000000 {
			opp-hz = <0x0 0x2367b880>;
			opp-microvolt = <0xc96a8 0xc96a8 0xf4240>;
		};
	};
	iommu@ffbb0f00 {
		compatible = "rockchip,iommu";
		reg = <0xffbb0f00 0x40 0xffbb0f40 0x40>;
		interrupts = <0x0 0x45 0x4 0x0 0x46 0x4>;
		interrupt-names = "rkvenc_mmu0", "rkvenc_mmu1";
		clocks = <0x2 0xa8 0x2 0xd3>;  /* 0x2->&{/clock-controller@ff490000}, 0xa8->&{/pinctrl/sdmmc0/sdmmc0-bus4}, 0x2->&{/clock-controller@ff490000}, 0xd3->&{/thermal-zones/cpu-thermal} */
		clock-names = "aclk", "iface";
		rockchip,disable-mmu-reset;
		rockchip,enable-cmd-retry;
		#iommu-cells = "", "", "", "";
		power-domains = <0x4d 0x8>;  /* 0x4d->&{/power-management@ff3e0000/power-controller}, 0x8->&{/otp@ff5c0000/id@7} */
		status = "okay";
		phandle = <0x97>;
	};
	pvtm@ffc00000 {
		compatible = "rockchip,rv1126-npu-pvtm";
		reg = <0xffc00000 0x100>;
		#address-cells = <0x1>;
		#size-cells = "", "", "", "";
		pvtm@1 {
			reg = <0x1>;
			clocks = <0x2 0x92 0x2 0x11a>;  /* 0x2->&{/clock-controller@ff490000}, 0x92->&{/rkisp-vir1/ports/port@1/endpoint@1}, 0x2->&{/clock-controller@ff490000}, 0x11a->&{/ethernet@ffc40000} */
			clock-names = "clk", "pclk";
			resets = <0x2 0xd7 0x2 0xd6>;  /* 0x2->&{/clock-controller@ff490000}, 0xd7->&{/oscillator}, 0x2->&{/clock-controller@ff490000}, 0xd6->&{/thermal-zones/npu-thermal} */
			reset-names = "rts", "rst-p";
		};
	};
	ethernet@ffc40000 {
		compatible = "rockchip,rv1126-gmac", "snps,dwmac-4.20a";
		reg = <0xffc40000 0xffff>;
		interrupts = <0x0 0x5f 0x4 0x0 0x60 0x4>;
		interrupt-names = "macirq", "eth_wake_irq";
		rockchip,grf = <0x48>;
		clocks = <0x2 0x7e 0x2 0x88 0x2 0x88 0x2 0x7f 0x2 0xbf 0x2 0x116 0x2 0x88 0x2 0x89>;  /* 0x2->&{/clock-controller@ff490000}, 0x7e->&{/dmc-opp-table}, 0x2->&{/clock-controller@ff490000}, 0x88->&{/mipi-dphy@ff4d0000}, 0x2->&{/clock-controller@ff490000}, 0x88->&{/mipi-dphy@ff4d0000}, 0x2->&{/clock-controller@ff490000}, 0x7f->&{/ddr_timing}, 0x2->&{/clock-controller@ff490000}, 0xbf->&{/saradc@ff5e0000}, 0x2->&{/clock-controller@ff490000}, 0x116->&{/rkispp-vir2}, 0x2->&{/clock-controller@ff490000}, 0x88->&{/mipi-dphy@ff4d0000}, 0x2->&{/clock-controller@ff490000}, 0x89->&{/iommu@ffb51a00} */
		clock-names = "stmmaceth", "mac_clk_rx", "mac_clk_tx", "clk_mac_ref", "aclk_mac", "pclk_mac", "clk_mac_speed", "ptp_ref";
		resets = <0x2 0xbe>;  /* 0x2->&{/clock-controller@ff490000}, 0xbe->&{/pinctrl/pcfg-pull-none-drv-level-0} */
		reset-names = "stmmaceth";
		snps,mixed-burst;
		snps,tso;
		snps,axi-config = <0x9a>;
		snps,mtl-rx-config = <0x9b>;
		snps,mtl-tx-config = <0x9c>;
		status = "okay";
		phy-mode = "rmii";
		clock_in_out = "output";
		snps,reset-gpio = <0x9d 0x11 0x1>;
		snps,reset-active-low;
		snps,reset-delays-us = <0x0 0xc350 0x2710>;
		assigned-clocks = <0x2 0x7b 0x2 0x7e 0x2 0x88>;  /* 0x2->&{/clock-controller@ff490000}, 0x7b->&{/pinctrl/auddsm/auddsm-pins}, 0x2->&{/clock-controller@ff490000}, 0x7e->&{/dmc-opp-table}, 0x2->&{/clock-controller@ff490000}, 0x88->&{/mipi-dphy@ff4d0000} */
		assigned-clock-rates = <0x0 0x2faf080>;
		assigned-clock-parents = <0x2 0x7a 0x2 0x7b 0x2 0x87>;  /* 0x2->&{/clock-controller@ff490000}, 0x7a->&{/pinctrl/audpwm/audpwmm0-pins}, 0x2->&{/clock-controller@ff490000}, 0x7b->&{/pinctrl/auddsm/auddsm-pins}, 0x2->&{/clock-controller@ff490000}, 0x87->&{/iommu@ffb20800} */
		pinctrl-names = "default";
		pinctrl-0 = <0x9e 0x9f 0xa0>;  /* 0x9e->&{/pinctrl/rmii/rmiim0-miim}, 0x9f->&{/pinctrl/rmii/rmiim0-bus2}, 0xa0->&{/pinctrl/gmac_clk/gmac-clk-m0-pins} */
		phy-handle = <&{/ethernet@ffc40000/mdio/phy@0}>;
		phandle = <0x11a>;
		mdio {
			compatible = "snps,dwmac-mdio";
			#address-cells = <0x1>;
			#size-cells = "", "", "", "";
			phandle = <0x11b>;
			phy@0 {
				compatible = "ethernet-phy-ieee802.3-c22";
				reg = "", "", "", "";
				phandle = <0xa1>;
			};
		};
		stmmac-axi-config {
			snps,wr_osr_lmt = <0x4>;
			snps,rd_osr_lmt = <0x8>;
			snps,blen = <0x0 0x0 0x0 0x0 0x10 0x8 0x4>;
			phandle = <0x9a>;
		};
		rx-queues-config {
			snps,rx-queues-to-use = <0x1>;
			phandle = <0x9b>;
			queue0 {
			};
		};
		tx-queues-config {
			snps,tx-queues-to-use = <0x1>;
			phandle = <0x9c>;
			queue0 {
			};
		};
	};
	dwmmc@ffc50000 {
		compatible = "rockchip,rv1126-dw-mshc", "rockchip,rk3288-dw-mshc";
		reg = <0xffc50000 0x4000>;
		interrupts = <0x0 0x4e 0x4>;
		clocks = <0x2 0xe8 0x2 0x72 0x2 0x73 0x2 0x74>;  /* 0x2->&{/clock-controller@ff490000}, 0xe8->&{/pwm@ff440030}, 0x2->&{/clock-controller@ff490000}, 0x72->&{/pinctrl/i2s1/i2s1m0-sdi}, 0x2->&{/clock-controller@ff490000}, 0x73->&{/pinctrl/i2s1/i2s1m0-sdo}, 0x2->&{/clock-controller@ff490000}, 0x74->&{/pinctrl/i2s2/i2s2m0-sclk} */
		clock-names = "biu", "ciu", "ciu-drive", "ciu-sample";
		fifo-depth = <0x100>;
		max-frequency = <0xbebc200>;
		pinctrl-names = "default";
		pinctrl-0 = <0xa2 0xa3 0xa4>;  /* 0xa2->&{/pinctrl/emmc/emmc-clk}, 0xa3->&{/pinctrl/emmc/emmc-cmd}, 0xa4->&{/pinctrl/emmc/emmc-bus8} */
		power-domains = <0x4d 0xf>;  /* 0x4d->&{/power-management@ff3e0000/power-controller}, 0xf->&{/reserved-memory/drm-logo@00000000} */
		rockchip,use-v2-tuning;
		status = "disabled";
		phandle = <0x11c>;
	};
	dwmmc@ffc60000 {
		compatible = "rockchip,rv1126-dw-mshc", "rockchip,rk3288-dw-mshc";
		reg = <0xffc60000 0x4000>;
		interrupts = <0x0 0x4c 0x4>;
		clocks = <0x2 0xe4 0x2 0x6c 0x2 0x6d 0x2 0x6e>;  /* 0x2->&{/clock-controller@ff490000}, 0xe4->&{/pwm@ff430030}, 0x2->&{/clock-controller@ff490000}, 0x6c->&{/pinctrl/tsadc/tsadcm0-shut}, 0x2->&{/clock-controller@ff490000}, 0x6d->&{/pinctrl/tsadc/tsadc-shutorg}, 0x2->&{/clock-controller@ff490000}, 0x6e->&{/otp@ff5c0000/npu-tsadc-trim-l@25} */
		clock-names = "biu", "ciu", "ciu-drive", "ciu-sample";
		fifo-depth = <0x100>;
		max-frequency = <0xbebc200>;
		pinctrl-names = "default";
		pinctrl-0 = <0xa5 0xa6 0xa7 0xa8>;  /* 0xa5->&{/pinctrl/sdmmc0/sdmmc0-clk}, 0xa6->&{/pinctrl/sdmmc0/sdmmc0-cmd}, 0xa7->&{/pinctrl/sdmmc0/sdmmc0-det}, 0xa8->&{/pinctrl/sdmmc0/sdmmc0-bus4} */
		status = "disabled";
		phandle = <0x11d>;
	};
	dwmmc@ffc70000 {
		compatible = "rockchip,rv1126-dw-mshc", "rockchip,rk3288-dw-mshc";
		reg = <0xffc70000 0x4000>;
		interrupts = <0x0 0x4d 0x4>;
		clocks = <0x2 0xe6 0x2 0x6f 0x2 0x70 0x2 0x71>;  /* 0x2->&{/clock-controller@ff490000}, 0xe6->&{/pwm@ff440010}, 0x2->&{/clock-controller@ff490000}, 0x6f->&{/otp@ff5c0000/npu-tsadc-trim-h@26}, 0x2->&{/clock-controller@ff490000}, 0x70->&{/pinctrl/i2s1/i2s1m0-sclk}, 0x2->&{/clock-controller@ff490000}, 0x71->&{/pinctrl/i2s1/i2s1m0-lrck} */
		clock-names = "biu", "ciu", "ciu-drive", "ciu-sample";
		fifo-depth = <0x100>;
		max-frequency = <0xbebc200>;
		pinctrl-names = "default";
		pinctrl-0 = <0xa9 0xaa 0xab>;  /* 0xa9->&{/pinctrl/sdio/sdio-clk}, 0xaa->&{/pinctrl/sdio/sdio-cmd}, 0xab->&{/pinctrl/sdio/sdio-bus4} */
		power-domains = <0x4d 0x10>;  /* 0x4d->&{/power-management@ff3e0000/power-controller}, 0x10->&{/vop@ffb00000/port/endpoint@1} */
		status = "okay";
		bus-width = <0x4>;
		cap-mmc-highspeed;
		cap-sd-highspeed;
		card-detect-delay = <0xc8>;
		cd-gpios = <0x51 0x14 0x1>;
		rockchip,default-sample-phase = <0x5a>;
		supports-sd;
		vqmmc-supply = <&{/vcc33sys}>;
		phandle = <0x11e>;
	};
	nandc@ffc80000 {
		compatible = "rockchip,rk-nandc";
		reg = <0xffc80000 0x4000>;
		interrupts = <0x0 0x4f 0x4>;
		nandc_id = "", "", "", "";
		clocks = <0x2 0x75 0x2 0xe9>;  /* 0x2->&{/clock-controller@ff490000}, 0x75->&{/pinctrl/i2s2/i2s2m0-lrck}, 0x2->&{/clock-controller@ff490000}, 0xe9->&{/spi@ff450000} */
		clock-names = "clk_nandc", "hclk_nandc";
		power-domains = <0x4d 0xf>;  /* 0x4d->&{/power-management@ff3e0000/power-controller}, 0xf->&{/reserved-memory/drm-logo@00000000} */
		status = "okay";
		#address-cells = <0x1>;
		#size-cells = "", "", "", "";
		phandle = <0x11f>;
		nand@0 {
			reg = "", "", "", "";
			nand-bus-width = <0x8>;
			nand-ecc-mode = "hw";
			nand-ecc-strength = <0x10>;
			nand-ecc-step-size = <0x400>;
		};
	};
	sfc@ffc90000 {
		compatible = "rockchip,sfc";
		reg = <0xffc90000 0x4000>;
		interrupts = <0x0 0x50 0x4>;
		clocks = <0x2 0x76 0x2 0xea>;  /* 0x2->&{/clock-controller@ff490000}, 0x76->&{/pinctrl/i2s2/i2s2m0-sdi}, 0x2->&{/clock-controller@ff490000}, 0xea->&{/csi-dphy@ff4b0000} */
		clock-names = "clk_sfc", "hclk_sfc";
		assigned-clocks = <0x2 0x76>;  /* 0x2->&{/clock-controller@ff490000}, 0x76->&{/pinctrl/i2s2/i2s2m0-sdi} */
		assigned-clock-rates = <0x4c4b400>;
		power-domains = <0x4d 0xf>;  /* 0x4d->&{/power-management@ff3e0000/power-controller}, 0xf->&{/reserved-memory/drm-logo@00000000} */
		status = "okay";
		phandle = <0x120>;
	};
	npu@ffbc0000 {
		compatible = "rockchip,npu";
		reg = <0xffbc0000 0x4000>;
		clocks = <0x2 0xc3 0x2 0xf0 0x2 0x119 0x2 0x90>;  /* 0x2->&{/clock-controller@ff490000}, 0xc3->&{/codec-digital@ff850000}, 0x2->&{/clock-controller@ff490000}, 0xf0->&{/i2c@ff510000/sc530ai@30}, 0x2->&{/clock-controller@ff490000}, 0x119->&{/vdpu@ffb90400}, 0x2->&{/clock-controller@ff490000}, 0x90->&{/rkispp@ffb60000} */
		clock-names = "aclk_npu", "hclk_npu", "pclk_pdnpu", "sclk_npu";
		assigned-clocks = <0x2 0x90 0x2 0xc3>;  /* 0x2->&{/clock-controller@ff490000}, 0x90->&{/rkispp@ffb60000}, 0x2->&{/clock-controller@ff490000}, 0xc3->&{/codec-digital@ff850000} */
		assigned-clock-rates = <0x179a7b00 0x23c34600>;
		operating-points-v2 = <0xac>;
		dynamic-power-coefficient = <0x53f>;
		#cooling-cells = <0x2>;
		interrupts = <0x0 0x6b 0x4>;
		power-domains = <0x4d 0x7>;  /* 0x4d->&{/power-management@ff3e0000/power-controller}, 0x7->&{/otp@ff5c0000/cpu-performance@1e} */
		status = "okay";
		npu-supply = <&{/vdd-arm-logic-npu-vepu-fixed}>;
		phandle = <0x1d>;
	};
	npu-opp-table {
		compatible = "operating-points-v2";
		nvmem-cells = <0xad 0xae>;
		nvmem-cell-names = "leakage", "performance";
		rockchip,temp-freq-table = <0x13880 0x927c0 0x15f90 0x60ae0 0x186a0 0x493e0>;
		clocks = <0x38 0x1>;  /* 0x38->&{/clock-controller@ff480000}, 0x1->&{/interrupt-controller@feff0000} */
		rockchip,bin-scaling-sel = <0x0 0x17 0x1 0x25 0x2 0x25>;
		rockchip,bin-voltage-sel = <0x2 0x0>;
		rockchip,pvtm-voltage-sel = <0x0 0x1b774 0x1 0x1b775 0x1cafc 0x2 0x1cafd 0xf423f 0x3>;
		rockchip,pvtm-freq = <0x60ae0>;
		rockchip,pvtm-volt = <0xc3500>;
		rockchip,pvtm-ch = <0x1 0x0>;
		rockchip,pvtm-sample-time = <0x3e8>;
		rockchip,pvtm-number = <0xa>;
		rockchip,pvtm-error = <0x3e8>;
		rockchip,pvtm-ref-temp = <0x25>;
		rockchip,pvtm-temp-prop = <0xffffffe3 0x0>;
		rockchip,pvtm-thermal-zone = "npu-thermal";
		phandle = <0xac>;
		opp-200000000 {
			opp-hz = <0x0 0xbebc200>;
			opp-microvolt = <0xb71b0 0xb71b0 0xf4240>;
			opp-microvolt-L0 = <0xc3500 0xc3500 0xf4240>;
		};
		opp-300000000 {
			opp-hz = <0x0 0x11e1a300>;
			opp-microvolt = <0xb71b0 0xb71b0 0xf4240>;
			opp-microvolt-L0 = <0xc3500 0xc3500 0xf4240>;
		};
		opp-396000000 {
			opp-hz = <0x0 0x179a7b00>;
			opp-microvolt = <0xb71b0 0xb71b0 0xf4240>;
			opp-microvolt-L0 = <0xc3500 0xc3500 0xf4240>;
		};
		opp-500000000 {
			opp-hz = <0x0 0x1dcd6500>;
			opp-microvolt = <0xb71b0 0xb71b0 0xf4240>;
			opp-microvolt-L0 = <0xc3500 0xc3500 0xf4240>;
		};
		opp-600000000 {
			opp-hz = <0x0 0x23c34600>;
			opp-microvolt = <0xb71b0 0xb71b0 0xf4240>;
			opp-microvolt-L0 = <0xc3500 0xc3500 0xf4240>;
		};
	};
	usb0 {
		compatible = "rockchip,rv1126-dwc3", "rockchip,rk3399-dwc3";
		#address-cells = <0x1>;
		#size-cells = <0x1>;
		ranges;
		clocks = <0x2 0x78 0x2 0xbd 0x2 0xc9>;  /* 0x2->&{/clock-controller@ff490000}, 0x78->&{/pinctrl/pdm/pdmm0-clk}, 0x2->&{/clock-controller@ff490000}, 0xbd->&{/pinctrl/pcfg-pull-up-drv-level-1}, 0x2->&{/clock-controller@ff490000}, 0xc9->&{/display-subsystem/route/route-rgb} */
		clock-names = "ref_clk", "bus_clk", "hclk";
		status = "okay";
		phandle = <0x121>;
		dwc3@ffd00000 {
			compatible = "snps,dwc3";
			reg = <0xffd00000 0x100000>;
			interrupts = <0x0 0x55 0x4>;
			dr_mode = "otg";
			maximum-speed = "high-speed";
			phys = <&{/usb2-phy@ff4c0000/otg-port}>;
			phy-names = "usb2-phy";
			phy_type = "utmi_wide";
			power-domains = <0x4d 0x11>;  /* 0x4d->&{/power-management@ff3e0000/power-controller}, 0x11->&{/vop@ffb00000/port/endpoint@0} */
			resets = <0x2 0xb5>;  /* 0x2->&{/clock-controller@ff490000}, 0xb5->&{/pinctrl/pcfg-pull-up} */
			reset-names = "usb3-otg";
			snps,dis_enblslpm_quirk;
			snps,dis-u2-freeclk-exists-quirk;
			snps,dis_u2_susphy_quirk;
			snps,dis-del-phy-power-chg-quirk;
			snps,tx-ipgap-linecheck-dis-quirk;
			snps,tx-fifo-resize;
			snps,xhci-trb-ent-quirk;
			status = "okay";
			extcon = <0xb0>;
			phandle = <0x122>;
		};
	};
	usb@ffe00000 {
		compatible = "generic-ehci";
		reg = <0xffe00000 0x10000>;
		interrupts = <0x0 0x52 0x4>;
		clocks = <0x2 0xed 0x2 0xee 0x4c>;  /* 0x2->&{/clock-controller@ff490000}, 0xed->&{/crypto@ff500000}, 0x2->&{/clock-controller@ff490000}, 0xee->&{/i2c@ff510000}, 0x4c->&{/usb2-phy@ff4c8000} */
		clock-names = "usbhost", "arbiter", "utmi";
		phys = <&{/usb2-phy@ff4c8000/host-port}>;
		phy-names = "usb";
		power-domains = <0x4d 0x11>;  /* 0x4d->&{/power-management@ff3e0000/power-controller}, 0x11->&{/vop@ffb00000/port/endpoint@0} */
		status = "disabled";
		phandle = <0x123>;
	};
	usb@ffe10000 {
		compatible = "generic-ohci";
		reg = <0xffe10000 0x10000>;
		interrupts = <0x0 0x53 0x4>;
		clocks = <0x2 0xed 0x2 0xee 0x4c>;  /* 0x2->&{/clock-controller@ff490000}, 0xed->&{/crypto@ff500000}, 0x2->&{/clock-controller@ff490000}, 0xee->&{/i2c@ff510000}, 0x4c->&{/usb2-phy@ff4c8000} */
		clock-names = "usbhost", "arbiter", "utmi";
		phys = <&{/usb2-phy@ff4c8000/host-port}>;
		phy-names = "usb";
		power-domains = <0x4d 0x11>;  /* 0x4d->&{/power-management@ff3e0000/power-controller}, 0x11->&{/vop@ffb00000/port/endpoint@0} */
		status = "disabled";
		phandle = <0x124>;
	};
	pinctrl {
		compatible = "rockchip,rv1126-pinctrl";
		rockchip,grf = <0x48>;
		rockchip,pmu = <0x3a>;
		#address-cells = <0x1>;
		#size-cells = <0x1>;
		ranges;
		pinctrl-names = "default";
		pinctrl-0 = <&{/pinctrl/sdmmc-pwr/sdmmc-pwr}>;
		phandle = <0x125>;
		gpio0@ff460000 {
			compatible = "rockchip,gpio-bank";
			reg = <0xff460000 0x100>;
			interrupts = <0x0 0x22 0x4>;
			clocks = <0x38 0x26 0x38 0x13>;  /* 0x38->&{/clock-controller@ff480000}, 0x26->&{/qos@fe8d0000}, 0x38->&{/clock-controller@ff480000}, 0x13->&{/reserved-memory/isp} */
			gpio-controller;
			#gpio-cells = <0x2>;
			interrupt-controller;
			#interrupt-cells = <0x2>;
			phandle = <0x4b>;
		};
		gpio1@ff620000 {
			compatible = "rockchip,gpio-bank";
			reg = <0xff620000 0x100>;
			interrupts = <0x0 0x23 0x4>;
			clocks = <0x2 0x106 0x2 0x28>;  /* 0x2->&{/clock-controller@ff490000}, 0x106->&{/decompress@ff6c0000}, 0x2->&{/clock-controller@ff490000}, 0x28->&{/qos@fe890080} */
			gpio-controller;
			#gpio-cells = <0x2>;
			interrupt-controller;
			#interrupt-cells = <0x2>;
			phandle = <0x51>;
		};
		gpio2@ff630000 {
			compatible = "rockchip,gpio-bank";
			reg = <0xff630000 0x100>;
			interrupts = <0x0 0x24 0x4>;
			clocks = <0x2 0x107 0x2 0x29>;  /* 0x2->&{/clock-controller@ff490000}, 0x107->&{/i2s@ff810000}, 0x2->&{/clock-controller@ff490000}, 0x29->&{/qos@fe890100} */
			gpio-controller;
			#gpio-cells = <0x2>;
			interrupt-controller;
			#interrupt-cells = <0x2>;
			phandle = <0x9d>;
		};
		gpio3@ff640000 {
			compatible = "rockchip,gpio-bank";
			reg = <0xff640000 0x100>;
			interrupts = <0x0 0x25 0x4>;
			clocks = <0x2 0x108 0x2 0x2a>;  /* 0x2->&{/clock-controller@ff490000}, 0x108->&{/i2s@ff820000}, 0x2->&{/clock-controller@ff490000}, 0x2a->&{/qos@fe8a0080} */
			gpio-controller;
			#gpio-cells = <0x2>;
			interrupt-controller;
			#interrupt-cells = <0x2>;
			phandle = <0x126>;
		};
		gpio4@ff650000 {
			compatible = "rockchip,gpio-bank";
			reg = <0xff650000 0x100>;
			interrupts = <0x0 0x26 0x4>;
			clocks = <0x2 0x109 0x2 0x2b>;  /* 0x2->&{/clock-controller@ff490000}, 0x109->&{/audpwm@ff840000}, 0x2->&{/clock-controller@ff490000}, 0x2b->&{/qos@fe8a0100} */
			gpio-controller;
			#gpio-cells = <0x2>;
			interrupt-controller;
			#interrupt-cells = <0x2>;
			phandle = <0x127>;
		};
		pcfg-pull-up {
			bias-pull-up;
			phandle = <0xb5>;
		};
		pcfg-pull-down {
			bias-pull-down;
			phandle = <0xb6>;
		};
		pcfg-pull-none {
			bias-disable;
			phandle = <0xb3>;
		};
		pcfg-pull-none-drv-level-0 {
			bias-disable;
			drive-strength = "", "", "", "";
			phandle = <0xbe>;
		};
		pcfg-pull-none-drv-level-2 {
			bias-disable;
			drive-strength = <0x2>;
			phandle = <0xb9>;
		};
		pcfg-pull-none-drv-level-3 {
			bias-disable;
			drive-strength = <0x3>;
			phandle = <0xbb>;
		};
		pcfg-pull-none-drv-level-8 {
			bias-disable;
			drive-strength = <0x8>;
			phandle = <0xb8>;
		};
		pcfg-pull-up-drv-level-0 {
			bias-pull-up;
			drive-strength = "", "", "", "";
			phandle = <0xbc>;
		};
		pcfg-pull-up-drv-level-1 {
			bias-pull-up;
			drive-strength = <0x1>;
			phandle = <0xbd>;
		};
		pcfg-pull-up-drv-level-2 {
			bias-pull-up;
			drive-strength = <0x2>;
			phandle = <0xb4>;
		};
		pcfg-pull-none-drv-level-0-smt {
			bias-disable;
			drive-strength = "", "", "", "";
			input-schmitt-enable;
			phandle = <0xb7>;
		};
		pcfg-output-low {
			output-low;
			phandle = <0xba>;
		};
		auddsm {
			auddsm-pins {
				rockchip,pins = <0x3 0x1b 0x5 0xb3 0x3 0x1d 0x5 0xb3 0x4 0x0 0x5 0xb3 0x4 0x1 0x5 0xb3>;
				phandle = <0x7b>;
			};
		};
		audpwm {
			audpwmm0-pins {
				rockchip,pins = <0x4 0x0 0x3 0xb3 0x4 0x1 0x3 0xb3>;
				phandle = <0x7a>;
			};
		};
		emmc {
			emmc-bus8 {
				rockchip,pins = <0x0 0x14 0x2 0xb4 0x0 0x15 0x2 0xb4 0x0 0x16 0x2 0xb4 0x0 0x17 0x2 0xb4 0x0 0x18 0x2 0xb4 0x0 0x19 0x2 0xb4 0x0 0x1a 0x2 0xb4 0x0 0x1b 0x2 0xb4>;
				phandle = <0xa4>;
			};
			emmc-clk {
				rockchip,pins = <0x0 0x1f 0x2 0xb4>;
				phandle = <0xa2>;
			};
			emmc-cmd {
				rockchip,pins = <0x0 0x1d 0x2 0xb4>;
				phandle = <0xa3>;
			};
		};
		i2c0 {
			i2c0-xfer {
				rockchip,pins = <0x0 0xc 0x1 0xb7 0x0 0xd 0x1 0xb7>;
				phandle = <0x39>;
			};
		};
		i2c1 {
			i2c1-xfer {
				rockchip,pins = <0x1 0x1b 0x1 0xb7 0x1 0x1a 0x1 0xb7>;
				phandle = <0x4e>;
			};
		};
		i2c2 {
			i2c2-xfer {
				rockchip,pins = <0x0 0x12 0x1 0xb7 0x0 0x13 0x1 0xb7>;
				phandle = <0x3b>;
			};
		};
		i2c3 {
			i2c3m0-xfer {
				rockchip,pins = <0x3 0x4 0x5 0xb7 0x3 0x5 0x5 0xb7>;
				phandle = <0x53>;
			};
		};
		i2c4 {
			i2c4m0-xfer {
				rockchip,pins = <0x3 0x0 0x7 0xb7 0x3 0x1 0x7 0xb7>;
				phandle = <0x54>;
			};
		};
		i2c5 {
			i2c5m0-xfer {
				rockchip,pins = <0x2 0x5 0x7 0xb7 0x2 0xb 0x7 0xb7>;
				phandle = <0x55>;
			};
		};
		i2s1 {
			i2s1m0-lrck {
				rockchip,pins = <0x1 0x0 0x4 0xb3>;
				phandle = <0x71>;
			};
			i2s1m0-sclk {
				rockchip,pins = <0x1 0x1 0x4 0xb3>;
				phandle = <0x70>;
			};
			i2s1m0-sdi {
				rockchip,pins = <0x1 0x2 0x4 0xb3>;
				phandle = <0x72>;
			};
			i2s1m0-sdo {
				rockchip,pins = <0x0 0x1e 0x4 0xb3>;
				phandle = <0x73>;
			};
		};
		i2s2 {
			i2s2m0-lrck {
				rockchip,pins = <0x1 0x17 0x1 0xb3>;
				phandle = <0x75>;
			};
			i2s2m0-sclk {
				rockchip,pins = <0x1 0x16 0x1 0xb3>;
				phandle = <0x74>;
			};
			i2s2m0-sdi {
				rockchip,pins = <0x1 0x15 0x1 0xb3>;
				phandle = <0x76>;
			};
			i2s2m0-sdo {
				rockchip,pins = <0x1 0x14 0x1 0xb3>;
				phandle = <0x77>;
			};
		};
		mipicsi {
			mipicsi-clk0 {
				rockchip,pins = <0x2 0x3 0x1 0xb3>;
				phandle = <0x4f>;
			};
		};
		pdm {
			pdmm0-clk {
				rockchip,pins = <0x3 0x1c 0x2 0xb3>;
				phandle = <0x78>;
			};
			pdmm0-sdi0 {
				rockchip,pins = <0x3 0x1e 0x2 0xb3>;
				phandle = <0x79>;
			};
		};
		pwm2 {
			pwm2m0-pins {
				rockchip,pins = <0x0 0x10 0x3 0xb3>;
				phandle = <0x42>;
			};
		};
		pwm3 {
			pwm3m0-pins {
				rockchip,pins = <0x0 0x11 0x3 0xb3>;
				phandle = <0x43>;
			};
		};
		pwm4 {
			pwm4m0-pins {
				rockchip,pins = <0x0 0x12 0x3 0xb3>;
				phandle = <0x44>;
			};
		};
		pwm5 {
			pwm5m0-pins {
				rockchip,pins = <0x0 0x13 0x3 0xb3>;
				phandle = <0x45>;
			};
		};
		pwm6 {
			pwm6m0-pins {
				rockchip,pins = <0x0 0xa 0x3 0xb3>;
				phandle = <0x46>;
			};
		};
		pwm7 {
			pwm7m0-pins {
				rockchip,pins = <0x0 0x9 0x3 0xb3>;
				phandle = <0x47>;
			};
		};
		pwm8 {
			pwm8m1-pins {
				rockchip,pins = <0x2 0x1f 0x5 0xb3>;
				phandle = <0x56>;
			};
		};
		pwm9 {
			pwm9m1-pins {
				rockchip,pins = <0x2 0x1e 0x5 0xb3>;
				phandle = <0x57>;
			};
		};
		pwm10 {
			pwm10m0-pins {
				rockchip,pins = <0x3 0x6 0x6 0xb3>;
				phandle = <0x58>;
			};
		};
		pwm11 {
			pwm11m0-pins {
				rockchip,pins = <0x3 0x7 0x6 0xb3>;
				phandle = <0x59>;
			};
		};
		sdio {
			sdio-bus4 {
				rockchip,pins = <0x1 0xc 0x1 0xb4 0x1 0xd 0x1 0xb4 0x1 0xe 0x1 0xb4 0x1 0xf 0x1 0xb4>;
				phandle = <0xab>;
			};
			sdio-clk {
				rockchip,pins = <0x1 0xa 0x1 0xb4>;
				phandle = <0xa9>;
			};
			sdio-cmd {
				rockchip,pins = <0x1 0xb 0x1 0xb4>;
				phandle = <0xaa>;
			};
		};
		sdmmc0 {
			sdmmc0-bus4 {
				rockchip,pins = <0x1 0x4 0x1 0xb4 0x1 0x5 0x1 0xb4 0x1 0x6 0x1 0xb4 0x1 0x7 0x1 0xb4>;
				phandle = <0xa8>;
			};
			sdmmc0-clk {
				rockchip,pins = <0x1 0x8 0x1 0xb4>;
				phandle = <0xa5>;
			};
			sdmmc0-cmd {
				rockchip,pins = <0x1 0x9 0x1 0xb4>;
				phandle = <0xa6>;
			};
			sdmmc0-det {
				rockchip,pins = <0x0 0x3 0x1 0xb3>;
				phandle = <0xa7>;
			};
		};
		spi1 {
			spi1m0-pins {
				rockchip,pins = <0x3 0x10 0x5 0xbc 0x3 0xf 0x5 0xbc 0x3 0xe 0x5 0xbc>;
				phandle = <0x67>;
			};
			spi1m0-cs0 {
				rockchip,pins = <0x3 0xd 0x5 0xbc>;
				phandle = <0x65>;
			};
			spi1m0-cs1 {
				rockchip,pins = <0x3 0xc 0x5 0xbc>;
				phandle = <0x66>;
			};
		};
		tsadc {
			tsadcm0-shut {
				rockchip,pins = <0x0 0x1 0x1 0xb3>;
				phandle = <0x6c>;
			};
			tsadc-shutorg {
				rockchip,pins = <0x0 0x1 0x2 0xb3>;
				phandle = <0x6d>;
			};
		};
		uart0 {
			uart0-xfer {
				rockchip,pins = <0x1 0x12 0x1 0xb5 0x1 0x13 0x1 0xb5>;
				phandle = <0x5a>;
			};
			uart0-ctsn {
				rockchip,pins = <0x1 0x11 0x1 0xb3>;
				phandle = <0x5b>;
			};
			uart0-rtsn {
				rockchip,pins = <0x1 0x10 0x1 0xb3>;
				phandle = <0x5c>;
			};
		};
		uart1 {
			uart1m0-xfer {
				rockchip,pins = <0x0 0xf 0x2 0xb5 0x0 0xe 0x2 0xb5>;
				phandle = <0x3d>;
			};
			uart1m0-ctsn {
				rockchip,pins = <0x0 0x11 0x2 0xb3>;
				phandle = <0x3e>;
			};
			uart1m0-rtsn {
				rockchip,pins = <0x0 0x10 0x2 0xb3>;
				phandle = <0x3f>;
			};
		};
		uart2 {
			uart2m1-xfer {
				rockchip,pins = <0x3 0x3 0x1 0xb5 0x3 0x2 0x1 0xb5>;
				phandle = <0x5d>;
			};
		};
		uart3 {
			uart3m2-xfer {
				rockchip,pins = <0x3 0x1 0x4 0xb5 0x3 0x0 0x4 0xb5>;
				phandle = <0x5e>;
			};
		};
		uart4 {
			uart4m0-xfer {
				rockchip,pins = <0x3 0x5 0x4 0xb5 0x3 0x4 0x4 0xb5>;
				phandle = <0x5f>;
			};
			uart4m0-ctsn {
				rockchip,pins = <0x3 0xb 0x4 0xb3>;
				phandle = <0x60>;
			};
			uart4m0-rtsn {
				rockchip,pins = <0x3 0xa 0x4 0xb3>;
				phandle = <0x61>;
			};
		};
		uart5 {
			uart5m0-xfer {
				rockchip,pins = <0x3 0x7 0x4 0xb5 0x3 0x6 0x4 0xb5>;
				phandle = <0x62>;
			};
			uart5m0-ctsn {
				rockchip,pins = <0x3 0x9 0x4 0xb3>;
				phandle = <0x63>;
			};
			uart5m0-rtsn {
				rockchip,pins = <0x3 0x8 0x4 0xb3>;
				phandle = <0x64>;
			};
		};
		pwm-pull-down {
			pwm0m0-pins {
				rockchip,pins = <0x0 0xe 0x3 0xb6>;
				phandle = <0x40>;
			};
			pwm1m0-pins {
				rockchip,pins = <0x0 0xf 0x3 0xb6>;
				phandle = <0x41>;
			};
		};
		spi1-hs {
			spi1m0-pins {
				rockchip,pins = <0x3 0x10 0x5 0xbd 0x3 0xf 0x5 0xbd 0x3 0xe 0x5 0xbd>;
				phandle = <0x68>;
			};
		};
		gmac_clk {
			gmac-clk-m0-pins {
				rockchip,pins = <0x3 0x10 0x2 0xb3>;
				phandle = <0xa0>;
			};
		};
		rmii {
			rmiim0-miim {
				rockchip,pins = <0x3 0x14 0x2 0xbe 0x3 0x13 0x2 0xb3>;
				phandle = <0x9e>;
			};
			rmiim0-bus2 {
				rockchip,pins = <0x3 0xe 0x2 0xb3 0x3 0xf 0x2 0xb3 0x3 0x11 0x2 0xb3 0x3 0x12 0x2 0xb3 0x3 0xb 0x2 0xbe 0x3 0xc 0x2 0xbe 0x3 0xd 0x2 0xbe>;
				phandle = <0x9f>;
			};
		};
		key {
			key-reset {
				rockchip,pins = <0x1 0x18 0x0 0xb3>;
				phandle = <0xc0>;
			};
		};
		sdmmc-pwr {
			sdmmc-pwr {
				rockchip,pins = <0x1 0x19 0x0 0xba>;
				phandle = <0xb2>;
			};
		};
	};
	chosen {
		bootargs = "coherent_pool=64K earlycon=uart8250,mmio32,0xff570000 console=ttyFIQ0 ubi.mtd=3 ubi.block=0,rootfs root=/dev/ubiblock0_0 rootfstype=squashfs           snd_aloop.index=7";
	};
	vccsys {
		compatible = "regulator-fixed";
		regulator-name = "vcc5v0_sys";
		regulator-always-on;
		regulator-boot-on;
		regulator-min-microvolt = <0x4c4b40>;
		regulator-max-microvolt = <0x4c4b40>;
		phandle = <0x128>;
	};
	vcc-1v8 {
		compatible = "regulator-fixed";
		regulator-name = "vcc_1v8";
		regulator-always-on;
		regulator-boot-on;
		regulator-min-microvolt = <0x1b7740>;
		regulator-max-microvolt = <0x1b7740>;
		phandle = <0x21>;
	};
	vcc-dvdd {
		compatible = "regulator-fixed";
		regulator-name = "vcc_dvdd";
		regulator-always-on;
		regulator-boot-on;
		regulator-min-microvolt = <0x124f80>;
		regulator-max-microvolt = <0x124f80>;
		phandle = <0x50>;
	};
	vcc33sys {
		compatible = "regulator-fixed";
		regulator-name = "vcc3v3_sys";
		regulator-always-on;
		regulator-boot-on;
		regulator-min-microvolt = <0x325aa0>;
		regulator-max-microvolt = <0x325aa0>;
		phandle = <0x20>;
	};
	vcc28sys {
		compatible = "regulator-fixed";
		regulator-name = "vcc2v8_sys";
		regulator-always-on;
		regulator-boot-on;
		regulator-min-microvolt = <0x2ab980>;
		regulator-max-microvolt = <0x2ab980>;
		phandle = <0x129>;
	};
	vdd-arm-logic-npu-vepu-fixed {
		compatible = "regulator-fixed";
		regulator-name = "vdd_arm_logic_npu_vepu-fixed";
		regulator-always-on;
		regulator-boot-on;
		regulator-min-microvolt = <0xd59f8>;
		regulator-max-microvolt = <0xd59f8>;
		phandle = <0x5>;
	};
	adc-keys {
		compatible = "adc-keys";
		io-channels = <0xbf 0x0>;
		io-channel-names = "buttons";
		poll-interval = <0x64>;
		keyup-threshold-microvolt = <0x1b7740>;
		esc-key {
			label = "esc";
			linux,code = <0x1>;
			press-threshold-microvolt = "", "", "", "";
		};
	};
	gpio-keys {
		status = "disabled";
		compatible = "gpio-keys";
		autorepeat;
		pinctrl-names = "default";
		pinctrl-0 = <&{/pinctrl/key/key-reset}>;
		reset {
			gpios = <0x51 0x18 0x1>;
			linux,code = <0x73>;
			label = "GPIO Key VOLUMEUP";
			linux,input-type = <0x1>;
			wakeup-source;
			debounce-interval = <0x64>;
		};
	};
	rkacdc-dig-sound {
		status = "okay";
		compatible = "simple-audio-card";
		simple-audio-card,format = "i2s";
		simple-audio-card,mclk-fs = <0x100>;
		simple-audio-card,name = "rockchip,acdc-dig-sound";
		simple-audio-card,bitclock-master = <0xc1>;
		simple-audio-card,frame-master = <0xc1>;
		phandle = <0x12a>;
		simple-audio-card,cpu {
			sound-dai = <0xc2>;
			phandle = <0x12b>;
		};
		simple-audio-card,codec {
			sound-dai = <0xc3>;
			phandle = <0xc1>;
		};
	};
	es7202-sound {
		status = "okay";
		compatible = "simple-audio-card";
		simple-audio-card,format = "pdm";
		simple-audio-card,mclk-fs = <0x100>;
		simple-audio-card,name = "rockchip,es7202-sound";
		phandle = <0x12c>;
		simple-audio-card,cpu {
			sound-dai = <0xc4>;
		};
		simple-audio-card,codec {
			sound-dai = <0xc5>;
		};
	};
	__symbols__ {
		ddr_timing = "/ddr_timing";
		cpu0 = "/cpus/cpu@f00";
		cpu1 = "/cpus/cpu@f01";
		cpu2 = "/cpus/cpu@f02";
		cpu3 = "/cpus/cpu@f03";
		CPU_SLEEP = "/cpus/idle-states/cpu-sleep";
		cpu0_opp_table = "/cpu0-opp-table";
		bus_soc = "/bus-soc";
		display_subsystem = "/display-subsystem";
		route_dsi = "/display-subsystem/route/route-dsi";
		route_rgb = "/display-subsystem/route/route-rgb";
		fiq_debugger = "/fiq-debugger";
		optee = "/firmware/optee";
		mpp_srv = "/mpp-srv";
		drm_logo = "/reserved-memory/drm-logo@00000000";
		isp_reserved = "/reserved-memory/isp";
		ramoops = "/reserved-memory/ramoops@8000000";
		rkcif_dvp = "/rkcif_dvp";
		rkcif_dvp_sditf = "/rkcif_dvp_sditf";
		rkcif_lite_mipi_lvds = "/rkcif_lite_mipi_lvds";
		rkcif_lite_sditf = "/rkcif_lite_sditf";
		rkcif_mipi_lvds = "/rkcif_mipi_lvds";
		cif_mipi_in = "/rkcif_mipi_lvds/port/endpoint";
		rkcif_mipi_lvds_sditf = "/rkcif_mipi_lvds_sditf";
		lvds_sditf = "/rkcif_mipi_lvds_sditf/port/endpoint";
		rockchip_suspend = "/rockchip-suspend";
		rockchip_system_monitor = "/rockchip-system-monitor";
		thermal_zones = "/thermal-zones";
		cpu_thermal = "/thermal-zones/cpu-thermal";
		threshold = "/thermal-zones/cpu-thermal/trips/trip-point-0";
		target = "/thermal-zones/cpu-thermal/trips/trip-point-1";
		soc_crit = "/thermal-zones/cpu-thermal/trips/soc-crit";
		npu_thermal = "/thermal-zones/npu-thermal";
		xin24m = "/oscillator";
		dummy_cpll = "/dummy_cpll";
		gmac_clkin_m0 = "/external-gmac-clockm0";
		gmac_clkini_m1 = "/external-gmac-clockm1";
		grf = "/syscon@fe000000";
		rgb = "/syscon@fe000000/rgb";
		rgb_in_vop = "/syscon@fe000000/rgb/ports/port@0/endpoint@0";
		pmugrf = "/syscon@fe020000";
		pmu_io_domains = "/syscon@fe020000/io-domains";
		qos_usb_host = "/qos@fe810000";
		qos_usb_otg = "/qos@fe810080";
		qos_npu = "/qos@fe850000";
		qos_emmc = "/qos@fe860000";
		qos_nandc = "/qos@fe860080";
		qos_sfc = "/qos@fe860200";
		qos_sdio = "/qos@fe86c000";
		qos_vepu_rd0 = "/qos@fe870000";
		qos_vepu_rd1 = "/qos@fe870080";
		qos_vepu_wr = "/qos@fe870100";
		qos_ispp_m0 = "/qos@fe880000";
		qos_ispp_m1 = "/qos@fe880080";
		qos_isp = "/qos@fe890000";
		qos_cif_lite = "/qos@fe890080";
		qos_cif = "/qos@fe890100";
		qos_iep = "/qos@fe8a0000";
		qos_rga_rd = "/qos@fe8a0080";
		qos_rga_wr = "/qos@fe8a0100";
		qos_vop = "/qos@fe8a0180";
		qos_vdpu = "/qos@fe8b0000";
		qos_jpeg = "/qos@fe8c0000";
		qos_crypto = "/qos@fe8d0000";
		gic = "/interrupt-controller@feff0000";
		pmu = "/power-management@ff3e0000";
		power = "/power-management@ff3e0000/power-controller";
		i2c0 = "/i2c@ff3f0000";
		es7202 = "/i2c@ff3f0000/es7202@30";
		i2c2 = "/i2c@ff400000";
		dmac = "/amba/dma-controller@ff4e0000";
		uart1 = "/serial@ff410000";
		pwm0 = "/pwm@ff430000";
		pwm1 = "/pwm@ff430010";
		pwm2 = "/pwm@ff430020";
		pwm3 = "/pwm@ff430030";
		pwm4 = "/pwm@ff440000";
		pwm5 = "/pwm@ff440010";
		pwm6 = "/pwm@ff440020";
		pwm7 = "/pwm@ff440030";
		spi0 = "/spi@ff450000";
		pmucru = "/clock-controller@ff480000";
		cru = "/clock-controller@ff490000";
		csi_dphy0 = "/csi-dphy@ff4b0000";
		mipi_in_ucam0 = "/csi-dphy@ff4b0000/ports/port@0/endpoint@1";
		csidphy0_out = "/csi-dphy@ff4b0000/ports/port@1/endpoint@0";
		csi_dphy1 = "/csi-dphy@ff4b8000";
		u2phy0 = "/usb2-phy@ff4c0000";
		u2phy_otg = "/usb2-phy@ff4c0000/otg-port";
		u2phy1 = "/usb2-phy@ff4c8000";
		u2phy_host = "/usb2-phy@ff4c8000/host-port";
		mipi_dphy = "/mipi-dphy@ff4d0000";
		rng = "/rng@ff500400";
		crypto = "/crypto@ff500000";
		i2c1 = "/i2c@ff510000";
		sc5338 = "/i2c@ff510000/sc5338@30";
		ucam_out0 = "/i2c@ff510000/sc5338@30/port/endpoint";
		sc530ai = "/i2c@ff510000/sc530ai@30";
		sc401ai = "/i2c@ff510000/sc401ai@30";
		i2c3 = "/i2c@ff520000";
		i2c4 = "/i2c@ff530000";
		pcf8563 = "/i2c@ff530000/pcf8563@51";
		i2c5 = "/i2c@ff540000";
		pwm8 = "/pwm@ff550000";
		pwm9 = "/pwm@ff550010";
		pwm10 = "/pwm@ff550020";
		pwm11 = "/pwm@ff550030";
		uart0 = "/serial@ff560000";
		uart2 = "/serial@ff570000";
		uart3 = "/serial@ff580000";
		uart4 = "/serial@ff590000";
		uart5 = "/serial@ff5a0000";
		spi1 = "/spi@ff5b0000";
		otp = "/otp@ff5c0000";
		otp_cpu_code = "/otp@ff5c0000/cpu-code@2";
		otp_id = "/otp@ff5c0000/id@7";
		cpu_leakage = "/otp@ff5c0000/cpu-leakage@17";
		logic_leakage = "/otp@ff5c0000/logic-leakage@18";
		npu_leakage = "/otp@ff5c0000/npu-leakage@19";
		venc_leakage = "/otp@ff5c0000/venc-leakage@1a";
		cpu_performance = "/otp@ff5c0000/cpu-performance@1e";
		npu_performance = "/otp@ff5c0000/npu-performance@1f";
		venc_performance = "/otp@ff5c0000/venc-performance@1f";
		cpu_tsadc_trim_l = "/otp@ff5c0000/cpu-tsadc-trim-l@23";
		cpu_tsadc_trim_h = "/otp@ff5c0000/cpu-tsadc-trim-h@24";
		npu_tsadc_trim_l = "/otp@ff5c0000/npu-tsadc-trim-l@25";
		npu_tsadc_trim_h = "/otp@ff5c0000/npu-tsadc-trim-h@26";
		tsadc_trim_base = "/otp@ff5c0000/tsadc-trim-base@27";
		saradc = "/saradc@ff5e0000";
		cpu_tsadc = "/tsadc@ff5f0000";
		npu_tsadc = "/tsadc@ff5f8000";
		dcf = "/dcf@ff600000";
		can = "/can@ff610000";
		rktimer = "/rktimer@ff660000";
		wdt = "/watchdog@ff680000";
		mailbox = "/mailbox@ff6a0000";
		hw_decompress = "/decompress@ff6c0000";
		i2s0_8ch = "/i2s@ff800000";
		i2s1_2ch = "/i2s@ff810000";
		i2s2_2ch = "/i2s@ff820000";
		pdm = "/pdm@ff830000";
		audpwm = "/audpwm@ff840000";
		rkacdc_dig = "/codec-digital@ff850000";
		dfi = "/dfi@ff9c0000";
		dmc = "/dmc";
		dmc_opp_table = "/dmc-opp-table";
		dmcdbg = "/dmcdbg";
		rkcif = "/rkcif@ffae0000";
		rkcif_mmu = "/iommu@ffae0800";
		rkcif_lite = "/rkcif_lite@ffae8000";
		rkcif_lite_mmu = "/iommu@ffae8800";
		rk_rga = "/rk_rga@ffaf0000";
		vop = "/vop@ffb00000";
		vop_out = "/vop@ffb00000/port";
		vop_out_rgb = "/vop@ffb00000/port/endpoint@0";
		vop_out_dsi = "/vop@ffb00000/port/endpoint@1";
		vop_mmu = "/iommu@ffb00f00";
		mipi_csi2 = "/mipi-csi2@ffb10000";
		mipi_csi2_input = "/mipi-csi2@ffb10000/ports/port@0/endpoint@1";
		mipi_csi2_output = "/mipi-csi2@ffb10000/ports/port@1/endpoint@0";
		iep = "/iep@ffb20000";
		iep_mmu = "/iommu@ffb20800";
		dsi = "/dsi@ffb30000";
		dsi_in_vop = "/dsi@ffb30000/ports/port/endpoint";
		rkisp = "/rkisp@ffb50000";
		rkisp_mmu = "/iommu@ffb51a00";
		rkisp_vir0 = "/rkisp-vir0";
		isp0_out = "/rkisp-vir0/ports/port@1/endpoint@1";
		isp_in = "/rkisp-vir0/ports/port@0/endpoint@0";
		rkisp_vir1 = "/rkisp-vir1";
		isp1_out = "/rkisp-vir1/ports/port@1/endpoint@1";
		rkisp_vir2 = "/rkisp-vir2";
		isp2_out = "/rkisp-vir2/ports/port@1/endpoint@1";
		rkispp = "/rkispp@ffb60000";
		rkispp_mmu = "/iommu@ffb60e00";
		rkispp_vir0 = "/rkispp-vir0";
		ispp0_in = "/rkispp-vir0/port/endpoint@0";
		rkispp_vir1 = "/rkispp-vir1";
		ispp1_in = "/rkispp-vir1/port/endpoint@0";
		rkispp_vir2 = "/rkispp-vir2";
		ispp2_in = "/rkispp-vir2/port/endpoint@0";
		rkvdec = "/rkvdec@ffb80000";
		rkvdec_mmu = "/iommu@ffb80480";
		vepu = "/vepu@ffb90000";
		vdpu = "/vdpu@ffb90400";
		vpu_mmu = "/iommu@ffb90800";
		rkvenc = "/rkvenc@ffbb0000";
		rkvenc_opp_table = "/rkvenc-opp-table";
		rkvenc_mmu = "/iommu@ffbb0f00";
		gmac = "/ethernet@ffc40000";
		mdio = "/ethernet@ffc40000/mdio";
		phy = "/ethernet@ffc40000/mdio/phy@0";
		stmmac_axi_setup = "/ethernet@ffc40000/stmmac-axi-config";
		mtl_rx_setup = "/ethernet@ffc40000/rx-queues-config";
		mtl_tx_setup = "/ethernet@ffc40000/tx-queues-config";
		emmc = "/dwmmc@ffc50000";
		sdmmc = "/dwmmc@ffc60000";
		sdio = "/dwmmc@ffc70000";
		nandc = "/nandc@ffc80000";
		sfc = "/sfc@ffc90000";
		npu = "/npu@ffbc0000";
		npu_opp_table = "/npu-opp-table";
		usbdrd = "/usb0";
		usbdrd_dwc3 = "/usb0/dwc3@ffd00000";
		usb_host0_ehci = "/usb@ffe00000";
		usb_host0_ohci = "/usb@ffe10000";
		pinctrl = "/pinctrl";
		gpio0 = "/pinctrl/gpio0@ff460000";
		gpio1 = "/pinctrl/gpio1@ff620000";
		gpio2 = "/pinctrl/gpio2@ff630000";
		gpio3 = "/pinctrl/gpio3@ff640000";
		gpio4 = "/pinctrl/gpio4@ff650000";
		pcfg_pull_up = "/pinctrl/pcfg-pull-up";
		pcfg_pull_down = "/pinctrl/pcfg-pull-down";
		pcfg_pull_none = "/pinctrl/pcfg-pull-none";
		pcfg_pull_none_drv_level_0 = "/pinctrl/pcfg-pull-none-drv-level-0";
		pcfg_pull_none_drv_level_2 = "/pinctrl/pcfg-pull-none-drv-level-2";
		pcfg_pull_none_drv_level_3 = "/pinctrl/pcfg-pull-none-drv-level-3";
		pcfg_pull_none_drv_level_8 = "/pinctrl/pcfg-pull-none-drv-level-8";
		pcfg_pull_up_drv_level_0 = "/pinctrl/pcfg-pull-up-drv-level-0";
		pcfg_pull_up_drv_level_1 = "/pinctrl/pcfg-pull-up-drv-level-1";
		pcfg_pull_up_drv_level_2 = "/pinctrl/pcfg-pull-up-drv-level-2";
		pcfg_pull_none_drv_level_0_smt = "/pinctrl/pcfg-pull-none-drv-level-0-smt";
		pcfg_output_low = "/pinctrl/pcfg-output-low";
		auddsm_pins = "/pinctrl/auddsm/auddsm-pins";
		audpwmm0_pins = "/pinctrl/audpwm/audpwmm0-pins";
		emmc_bus8 = "/pinctrl/emmc/emmc-bus8";
		emmc_clk = "/pinctrl/emmc/emmc-clk";
		emmc_cmd = "/pinctrl/emmc/emmc-cmd";
		i2c0_xfer = "/pinctrl/i2c0/i2c0-xfer";
		i2c1_xfer = "/pinctrl/i2c1/i2c1-xfer";
		i2c2_xfer = "/pinctrl/i2c2/i2c2-xfer";
		i2c3m0_xfer = "/pinctrl/i2c3/i2c3m0-xfer";
		i2c4m0_xfer = "/pinctrl/i2c4/i2c4m0-xfer";
		i2c5m0_xfer = "/pinctrl/i2c5/i2c5m0-xfer";
		i2s1m0_lrck = "/pinctrl/i2s1/i2s1m0-lrck";
		i2s1m0_sclk = "/pinctrl/i2s1/i2s1m0-sclk";
		i2s1m0_sdi = "/pinctrl/i2s1/i2s1m0-sdi";
		i2s1m0_sdo = "/pinctrl/i2s1/i2s1m0-sdo";
		i2s2m0_lrck = "/pinctrl/i2s2/i2s2m0-lrck";
		i2s2m0_sclk = "/pinctrl/i2s2/i2s2m0-sclk";
		i2s2m0_sdi = "/pinctrl/i2s2/i2s2m0-sdi";
		i2s2m0_sdo = "/pinctrl/i2s2/i2s2m0-sdo";
		mipicsi_clk0 = "/pinctrl/mipicsi/mipicsi-clk0";
		pdmm0_clk = "/pinctrl/pdm/pdmm0-clk";
		pdmm0_sdi0 = "/pinctrl/pdm/pdmm0-sdi0";
		pwm2m0_pins = "/pinctrl/pwm2/pwm2m0-pins";
		pwm3m0_pins = "/pinctrl/pwm3/pwm3m0-pins";
		pwm4m0_pins = "/pinctrl/pwm4/pwm4m0-pins";
		pwm5m0_pins = "/pinctrl/pwm5/pwm5m0-pins";
		pwm6m0_pins = "/pinctrl/pwm6/pwm6m0-pins";
		pwm7m0_pins = "/pinctrl/pwm7/pwm7m0-pins";
		pwm8m1_pins = "/pinctrl/pwm8/pwm8m1-pins";
		pwm9m1_pins = "/pinctrl/pwm9/pwm9m1-pins";
		pwm10m0_pins = "/pinctrl/pwm10/pwm10m0-pins";
		pwm11m0_pins = "/pinctrl/pwm11/pwm11m0-pins";
		sdio_bus4 = "/pinctrl/sdio/sdio-bus4";
		sdio_clk = "/pinctrl/sdio/sdio-clk";
		sdio_cmd = "/pinctrl/sdio/sdio-cmd";
		sdmmc0_bus4 = "/pinctrl/sdmmc0/sdmmc0-bus4";
		sdmmc0_clk = "/pinctrl/sdmmc0/sdmmc0-clk";
		sdmmc0_cmd = "/pinctrl/sdmmc0/sdmmc0-cmd";
		sdmmc0_det = "/pinctrl/sdmmc0/sdmmc0-det";
		spi1m0_pins = "/pinctrl/spi1/spi1m0-pins";
		spi1m0_cs0 = "/pinctrl/spi1/spi1m0-cs0";
		spi1m0_cs1 = "/pinctrl/spi1/spi1m0-cs1";
		tsadcm0_shut = "/pinctrl/tsadc/tsadcm0-shut";
		tsadc_shutorg = "/pinctrl/tsadc/tsadc-shutorg";
		uart0_xfer = "/pinctrl/uart0/uart0-xfer";
		uart0_ctsn = "/pinctrl/uart0/uart0-ctsn";
		uart0_rtsn = "/pinctrl/uart0/uart0-rtsn";
		uart1m0_xfer = "/pinctrl/uart1/uart1m0-xfer";
		uart1m0_ctsn = "/pinctrl/uart1/uart1m0-ctsn";
		uart1m0_rtsn = "/pinctrl/uart1/uart1m0-rtsn";
		uart2m1_xfer = "/pinctrl/uart2/uart2m1-xfer";
		uart3m2_xfer = "/pinctrl/uart3/uart3m2-xfer";
		uart4m0_xfer = "/pinctrl/uart4/uart4m0-xfer";
		uart4m0_ctsn = "/pinctrl/uart4/uart4m0-ctsn";
		uart4m0_rtsn = "/pinctrl/uart4/uart4m0-rtsn";
		uart5m0_xfer = "/pinctrl/uart5/uart5m0-xfer";
		uart5m0_ctsn = "/pinctrl/uart5/uart5m0-ctsn";
		uart5m0_rtsn = "/pinctrl/uart5/uart5m0-rtsn";
		pwm0m0_pins_pull_down = "/pinctrl/pwm-pull-down/pwm0m0-pins";
		pwm1m0_pins_pull_down = "/pinctrl/pwm-pull-down/pwm1m0-pins";
		spi1m0_pins_hs = "/pinctrl/spi1-hs/spi1m0-pins";
		gmac_clk_m0_pins = "/pinctrl/gmac_clk/gmac-clk-m0-pins";
		rmiim0_miim = "/pinctrl/rmii/rmiim0-miim";
		rmiim0_bus2 = "/pinctrl/rmii/rmiim0-bus2";
		key_reset = "/pinctrl/key/key-reset";
		sdmmc_pwr = "/pinctrl/sdmmc-pwr/sdmmc-pwr";
		vcc5v0_sys = "/vccsys";
		vcc_1v8 = "/vcc-1v8";
		vcc_dvdd = "/vcc-dvdd";
		vcc3v3_sys = "/vcc33sys";
		vcc2v8_sys = "/vcc28sys";
		vdd_arm_logic_npu_vepu_fixed = "/vdd-arm-logic-npu-vepu-fixed";
		rkacdc_dig_sound = "/rkacdc-dig-sound";
		sndcpu = "/rkacdc-dig-sound/simple-audio-card,cpu";
		sndcodec = "/rkacdc-dig-sound/simple-audio-card,codec";
		es7202_sound = "/es7202-sound";
	};
};
